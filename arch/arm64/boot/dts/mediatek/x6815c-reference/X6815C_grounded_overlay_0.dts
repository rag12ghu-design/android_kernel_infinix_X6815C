/dts-v1/;
// version: 17
// last_comp_version: 16
// boot_cpuid_phys: 0x0

/ {
    fragment@0 {
        target = <0xFFFFFFFF>;
        __overlay__ {
            atag,videolfb-fb_base_l = "~`P";
            atag,videolfb-fb_base_h = <0x0>;
            atag,videolfb-islcmfound = <0x1>;
            atag,videolfb-islcm_inited = <0x0>;
            atag,videolfb-fps = <0x1770>;
            atag,videolfb-vramSize = <0x1BE0000>;
            atag,videolfb-lcmname = "td4330_fhdp_dsi_cmd_auo_rt4831_drv";
        };
    };
    fragment@1 {
        target = <0xFFFFFFFF>;
        __overlay__ {
            pinctrl-names = "irtx_gpio_led_default", "irtx_gpio_led_set";
            pinctrl-0 = <0x1>;
            pinctrl-1 = <0x2>;
            status = "okay";
        };
    };
    fragment@2 {
        target = <0xFFFFFFFF>;
        __overlay__ {
            nfc {
                compatible = "mediatek,nfc-gpio-v2";
                gpio-rst = <0xA>;
                gpio-rst-std = <0xFFFFFFFF 0xA 0x0>;
                gpio-irq = <0xB>;
                gpio-irq-std = <0xFFFFFFFF 0xB 0x0>;
                phandle = <0x4E>;
            };
            irq_nfc {
                compatible = "mediatek,irq_nfc-eint";
                interrupt-parent = <0xFFFFFFFF>;
                interrupts = <0xB 0x4>;
                status = "okay";
                phandle = <0x4F>;
            };
        };
    };
    fragment@3 {
        target = <0xFFFFFFFF>;
        __overlay__ {
            status = "okay";
            nfc_nxp@28 {
                compatible = "nxp,pn544";
                reg = <0x28>;
                nxp,pn544-irq = <0xFFFFFFFF 0xB 0x0>;
                nxp,pn544-ven = <0xFFFFFFFF 0xA 0x0>;
                nxp,pn544-fw-dwnld = <0xFFFFFFFF 0x7 0x0>;
            };
        };
    };
    fragment@4 {
        target = <0xFFFFFFFF>;
        __overlay__ {
            irtx_gpio_led_def@gpio139 {
                phandle = <0x1>;
                pins_cmd_dat {
                    pinmux = <0x8B00>;
                    slew-rate = <0x1>;
                    bias-disable;
                    output-low;
                    input-schmitt-enable = <0x0>;
                };
            };
            irtx_gpio_led_set@gpio139 {
                phandle = <0x2>;
                pins_cmd_dat {
                    pinmux = <0x8B02>;
                    slew-rate = <0x1>;
                    output-high;
                };
            };
        };
    };
    fragment@5 {
        target = <0xFFFFFFFF>;
        __overlay__ {
            mt6360,intr_gpio_num = <0x4>;
            mt6360,intr_gpio = <0xFFFFFFFF 0x4 0x0>;
            mt6360,tc30_dp_gpio = <0xFFFFFFFF 0x6E 0x0>;
            mt6360,tc30_dm_gpio = <0xFFFFFFFF 0x8A 0x0>;
        };
    };
    fragment@6 {
        target = <0xFFFFFFFF>;
        __overlay__ {
            pwr_off_seq = <0x4000002>;
        };
    };
    fragment@7 {
        target = <0xFFFFFFFF>;
        __overlay__ {
            mt6360pd,intr_gpio_num = <0x5>;
            mt6360pd,intr_gpio = <0xFFFFFFFF 0x5 0x0>;
        };
    };
    fragment@8 {
        target = <0xFFFFFFFF>;
        __overlay__ {
            lcd_bias_enp1_gpio {
                phandle = <0x3>;
                pins_cmd_dat {
                    pinmux = <0x6B00>;
                    slew-rate = <0x1>;
                    output-high;
                };
            };
            lcd_bias_enp0_gpio {
                phandle = <0x4>;
                pins_cmd_dat {
                    pinmux = <0x6B00>;
                    slew-rate = <0x1>;
                    output-low;
                };
            };
            lcd_bias_enn1_gpio {
                phandle = <0x5>;
                pins_cmd_dat {
                    pinmux = <0x6C00>;
                    slew-rate = <0x1>;
                    output-high;
                };
            };
            lcd_bias_enn0_gpio {
                phandle = <0x6>;
                pins_cmd_dat {
                    pinmux = <0x6C00>;
                    slew-rate = <0x1>;
                    output-low;
                };
            };
            lcm_rst_out1_gpio {
                phandle = <0x7>;
                pins_cmd_dat {
                    pinmux = <0x2800>;
                    slew-rate = <0x1>;
                    output-high;
                };
            };
            lcm_rst_out0_gpio {
                phandle = <0x8>;
                pins_cmd_dat {
                    pinmux = <0x2800>;
                    slew-rate = <0x1>;
                    output-low;
                };
            };
            lcm_dsi_te {
                phandle = <0x9>;
                pins_cmd_dat {
                    pinmux = <0x2701>;
                };
            };
        };
    };
    fragment@9 {
        target = <0xFFFFFFFF>;
        __overlay__ {
            pinctrl-names = "lcd_bias_enp1_gpio", "lcd_bias_enp0_gpio", "lcd_bias_enn1_gpio", "lcd_bias_enn0_gpio", "lcm_rst_out1_gpio", "lcm_rst_out0_gpio", "mode_te_te";
            pinctrl-0 = <0x3>;
            pinctrl-1 = <0x4>;
            pinctrl-2 = <0x5>;
            pinctrl-3 = <0x6>;
            pinctrl-4 = <0x7>;
            pinctrl-5 = <0x8>;
            pinctrl-6 = <0x9>;
            status = "okay";
        };
    };
    fragment@10 {
        target = <0xFFFFFFFF>;
        __overlay__ {
            pinctrl-names = "lcm_rst_out1_gpio", "lcm_rst_out0_gpio", "mode_te_te";
            pinctrl-0 = <0x7>;
            pinctrl-1 = <0x8>;
            pinctrl-2 = <0x9>;
            status = "okay";
        };
    };
    fragment@11 {
        target = <0xFFFFFFFF>;
        __overlay__ {
            status = "okay";
            #address-cells = <0x1>;
            #size-cells = <0x0>;
            panel1@0 {
                compatible = "nt36672c,fhdp,dsi,vdo,tm,tm,120hz,x6815c";
                reg = <0x0>;
                reset-gpios = <0xFFFFFFFF 0x28 0x0>;
                bias-gpios = <0xFFFFFFFF 0x6B 0x0 0xFFFFFFFF 0x6C 0x0>;
                pinctrl-names = "default";
                port {
                    endpoint {
                        remote-endpoint = <0xA>;
                        phandle = <0xB>;
                    };
                };
            };
            ports {
                port {
                    endpoint {
                        remote-endpoint = <0xB>;
                        phandle = <0xA>;
                    };
                };
            };
        };
    };
    fragment@12 {
        target = <0xFFFFFFFF>;
        __overlay__ {
            flashlights_aw36515 {
                compatible = "mediatek,flashlights_aw36515";
                pinctrl-names = "aw36515default", "aw36515hwen_high", "aw36515hwen_low";
                pinctrl-0 = <0xC>;
                pinctrl-1 = <0xD>;
                pinctrl-2 = <0xE>;
                status = "okay";
                phandle = <0x50>;
            };
            cam_vdd_ext {
                compatible = "mediatek,cam_vdd_ext";
                pinctrl-names = "extldodefault", "extldo_en_high", "extldo_en_low";
                pinctrl-0 = <0xF>;
                pinctrl-1 = <0x10>;
                pinctrl-2 = <0x11>;
                status = "okay";
                phandle = <0x51>;
            };
            led@0 {
                compatible = "mediatek,red";
                led_mode = <0x0>;
                data = <0x1>;
                pwm_config = <0x0 0x0 0x0 0x0 0x0>;
                phandle = <0x52>;
            };
            led@1 {
                compatible = "mediatek,green";
                led_mode = <0x0>;
                data = <0x1>;
                pwm_config = <0x0 0x0 0x0 0x0 0x0>;
                phandle = <0x53>;
            };
            led@2 {
                compatible = "mediatek,blue";
                led_mode = <0x0>;
                data = <0x1>;
                pwm_config = <0x0 0x0 0x0 0x0 0x0>;
                phandle = <0x54>;
            };
            led@3 {
                compatible = "mediatek,jogball-backlight";
                led_mode = <0x0>;
                data = <0x1>;
                pwm_config = <0x0 0x0 0x0 0x0 0x0>;
                phandle = <0x55>;
            };
            led@4 {
                compatible = "mediatek,keyboard-backlight";
                led_mode = <0x0>;
                data = <0x1>;
                pwm_config = <0x0 0x0 0x0 0x0 0x0>;
                phandle = <0x56>;
            };
            led@5 {
                compatible = "mediatek,button-backlight";
                led_mode = <0x0>;
                data = <0x1>;
                pwm_config = <0x0 0x0 0x0 0x0 0x0>;
                phandle = <0x57>;
            };
            led@6 {
                compatible = "mediatek,lcd-backlight";
                led_mode = <0x5>;
                data = <0x1>;
                pwm_config = <0x1 0x0 0x0 0x0 0x0>;
                phandle = <0x58>;
            };
            vibrator@0 {
                compatible = "mediatek,vibrator";
                vib_timer = <0x19>;
                vib_limit = <0x9>;
                vib_vol = <0xB>;
                phandle = <0x59>;
            };
            fingerprint {
                compatible = "tran_fp";
                interrupt-parent = <0xFFFFFFFF>;
                interrupts = <0x16 0x1 0x16 0x0>;
                debounce = <0x16 0x0>;
                pinctrl-names = "tran_fp_default", "tran_fp_pin_irq", "tran_fp_irq_pull_down", "tran_fp_reset_high", "tran_fp_reset_low";
                pinctrl-0 = <0x12>;
                pinctrl-1 = <0x13>;
                pinctrl-2 = <0x14>;
                pinctrl-3 = <0x15>;
                pinctrl-4 = <0x16>;
                status = "okay";
                phandle = <0x5A>;
            };
        };
    };
    fragment@13 {
        target = <0xFFFFFFFF>;
        __overlay__ {
            fingerprint@0 {
                compatible = "tran_fp";
                reg = <0x0>;
                spi-max-frequency = <0x19BFCC0>;
                interrupt-parent = <0xFFFFFFFF>;
                interrupts = <0x16 0x1 0x16 0x0>;
                debounce = <0x16 0x0>;
                irq-gpio = <0x16>;
                irq-gpio-std = <0xFFFFFFFF 0x16 0x0>;
                reset-gpio = <0x15>;
                reset-gpio-std = <0xFFFFFFFF 0x15 0x0>;
                vmch-supply = <0xFFFFFFFF>;
                pinctrl-names = "tran_fp_default", "tran_fp_pin_irq", "tran_fp_irq_pull_down", "tran_fp_reset_high", "tran_fp_reset_low";
                silead;
                pinctrl-0 = <0x12>;
                pinctrl-1 = <0x13>;
                pinctrl-2 = <0x14>;
                pinctrl-3 = <0x15>;
                pinctrl-4 = <0x16>;
                status = "okay";
            };
        };
    };
    fragment@14 {
        target = <0xFFFFFFFF>;
        __overlay__ {
            fingerprint_default {
                phandle = <0x12>;
            };
            gpio22_eint {
                phandle = <0x13>;
                pins_cmd_dat {
                    pinmux = <0x1600>;
                    slew-rate = <0x0>;
                    bias-disable;
                };
            };
            gpio22_eint_pull_down {
                phandle = <0x14>;
                pins_cmd_dat {
                    pinmux = <0x1600>;
                    slew-rate = <0x0>;
                    bias-pull-down = <0x0>;
                    output-low;
                };
            };
            rst_out_one {
                phandle = <0x15>;
                pins_cmd_dat {
                    pinmux = <0x1500>;
                    slew-rate = <0x1>;
                    bias-disable;
                    output-high;
                };
            };
            rst_out_zero {
                phandle = <0x16>;
                pins_cmd_dat {
                    pinmux = <0x1500>;
                    slew-rate = <0x1>;
                    bias-disable;
                    output-low;
                };
            };
        };
    };
    fragment@15 {
        target = <0xFFFFFFFF>;
        __overlay__ {
            gps_default {
                phandle = <0x17>;
            };
            gps_l1_lna@0 {
                phandle = <0x18>;
                pins_cmd_dat {
                    pinmux = <0xBC00>;
                    output-low;
                };
            };
            gps_l1_lna@1 {
                phandle = <0x19>;
                pins_cmd_dat {
                    pinmux = <0xBC04>;
                };
            };
            gps_l1_lna@2 {
                phandle = <0x1A>;
                pins_cmd_dat {
                    pinmux = <0xBC00>;
                    output-high;
                };
            };
            gps_l5_lna@0 {
                phandle = <0x1B>;
                pins_cmd_dat {
                    pinmux = <0xBD00>;
                    output-low;
                };
            };
            gps_l5_lna@1 {
                phandle = <0x1C>;
                pins_cmd_dat {
                    pinmux = <0xBD04>;
                };
            };
            gps_l5_lna@2 {
                phandle = <0x1D>;
                pins_cmd_dat {
                    pinmux = <0xBD00>;
                    output-high;
                };
            };
        };
    };
    fragment@16 {
        target = <0xFFFFFFFF>;
        __overlay__ {
            pinctrl-names = "default", "gps_l1_lna_disable", "gps_l1_lna_dsp_ctrl", "gps_l1_lna_enable", "gps_l5_lna_disable", "gps_l5_lna_dsp_ctrl", "gps_l5_lna_enable";
            pinctrl-0 = <0x17>;
            pinctrl-1 = <0x18>;
            pinctrl-2 = <0x19>;
            pinctrl-3 = <0x1A>;
            pinctrl-4 = <0x1B>;
            pinctrl-5 = <0x1C>;
            pinctrl-6 = <0x1D>;
            status = "okay";
        };
    };
    fragment@17 {
        target = <0xFFFFFFFF>;
        __overlay__ {
            accdet-mic-vol = <0x8>;
            headset-mode-setting = <0x500 0x500 0x1 0x1F0 0x800 0x800 0x20 0x44 0x4 0x1 0x5 0x3 0x3 0x5 0xE>;
            accdet-plugout-debounce = <0x1>;
            accdet-mic-mode = <0x2>;
            headset-three-key-threshold = <0x0 0x50 0xDC 0x190>;
            headset-three-key-threshold-CDD = <0x0 0x79 0xC0 0x258>;
            headset-four-key-threshold = <0x0 0x3A 0x79 0xC0 0x190>;
            eint_use_ext_res = <0x0>;
            status = "okay";
        };
    };
    fragment@18 {
        target = <0xFFFFFFFF>;
        __overlay__ {
            pinctrl-names = "default";
            pinctrl-0 = <0x1E>;
        };
    };
    fragment@19 {
        target = <0xFFFFFFFF>;
        __overlay__ {
            kpdgpiodefault {
                phandle = <0x1E>;
                pins_cmd_dat {
                    pinmux = <0x7401>;
                    bias-pull-up = <0x66>;
                    input-enable;
                    input-schmitt-enable;
                };
            };
        };
    };
    fragment@20 {
        target = <0xFFFFFFFF>;
        __overlay__ {
            pinctrl-names = "enable", "disable";
            pinctrl-0 = <0x1F>;
            pinctrl-1 = <0x20>;
            status = "disable";
        };
    };
    fragment@21 {
        target = <0xFFFFFFFF>;
        __overlay__ {
            pinctrl-names = "sel_up", "sel_down";
            pinctrl-0 = <0x21>;
            pinctrl-1 = <0x22>;
            status = "okay";
        };
    };
    fragment@22 {
        target = <0xFFFFFFFF>;
        __overlay__ {
            ps_enable {
                phandle = <0x1F>;
                pins_cmd_dat {
                    pinmux = <0x7900>;
                    output-high;
                };
            };
            ps_disable {
                phandle = <0x20>;
                pins_cmd_dat {
                    pinmux = <0x7900>;
                    output-low;
                };
            };
            sel_up {
                phandle = <0x21>;
                pins_cmd_dat {
                    pinmux = <0x600>;
                    output-high;
                };
            };
            sel_down {
                phandle = <0x22>;
                pins_cmd_dat {
                    pinmux = <0x600>;
                    output-low;
                };
            };
        };
    };
    fragment@23 {
        target = <0xFFFFFFFF>;
        __overlay__ {
            compatible = "mediatek,touch";
            tpd-resolution = <0x438 0x99C>;
            use-tpd-button = <0x0>;
            tpd-key-num = <0x3>;
            tpd-key-local = <0x8B 0xAC 0x9E 0x0>;
            tpd-key-dim-local = <0x5A 0x373 0x64 0x28 0xE6 0x373 0x64 0x28 0x172 0x373 0x64 0x28 0x0 0x0 0x0 0x0>;
            tpd-max-touch-num = <0xA>;
            tpd-filter-enable = <0x0>;
            tpd-filter-pixel-density = <0xA8>;
            tpd-filter-custom-prameters = <0x0 0x0 0x0 0x0 0x0 0x0 0x0 0x0 0x0 0x0 0x0 0x0>;
            tpd-filter-custom-speed = <0x0 0x0 0x0>;
            pinctrl-names = "default", "state_eint_as_int", "state_eint_output0", "state_eint_output1", "state_rst_output0", "state_rst_output1", "state_spi_mode";
            pinctrl-0 = <0x23>;
            pinctrl-1 = <0x24>;
            pinctrl-2 = <0x25>;
            pinctrl-3 = <0x26>;
            pinctrl-4 = <0x27>;
            pinctrl-5 = <0x28>;
            pinctrl-6 = <0x29>;
            status = "okay";
        };
    };
    fragment@24 {
        target = <0xFFFFFFFF>;
        __overlay__ {
            eint0default {
                phandle = <0x23>;
            };
            eint@0 {
                phandle = <0x24>;
                pins_cmd_dat {
                    pinmux = <0xE00>;
                    slew-rate = <0x0>;
                    bias-disable;
                };
            };
            eintoutput0 {
                phandle = <0x25>;
                pins_cmd_dat {
                    pinmux = <0xE00>;
                    slew-rate = <0x1>;
                    output-low;
                };
            };
            eintoutput1 {
                phandle = <0x26>;
                pins_cmd_dat {
                    pinmux = <0xE00>;
                    slew-rate = <0x1>;
                    output-high;
                };
            };
            rstoutput0 {
                phandle = <0x27>;
                pins_cmd_dat {
                    pinmux = <0xF00>;
                    slew-rate = <0x1>;
                    output-low;
                };
            };
            rstoutput1 {
                phandle = <0x28>;
                pins_cmd_dat {
                    pinmux = <0xF00>;
                    slew-rate = <0x1>;
                    output-high;
                };
            };
            spimode_default {
                phandle = <0x29>;
                pins_cmd_dat {
                    pinmux = <0xC02 0xD02 0x4002 0x4102>;
                    drive-strength = <0x2>;
                };
            };
        };
    };
    fragment@25 {
        target = <0xFFFFFFFF>;
        __overlay__ {
            touch@0 {
                compatible = "novatek,NVT-ts-spi";
                reg = <0x0>;
                spi-max-frequency = <0x7A1200>;
                status = "okay";
                novatek,swrst-n8-addr = <0x3F0FE>;
                novatek,spi-rd-fast-addr = <0x3F310>;
                novatek,mp-support-dt;
                phandle = <0x5B>;
                novatek-mp-criteria-6283@0 {
                    #address-cells = <0x1>;
                    #size-cells = <0x0>;
                    compatible = "novatek-mp-criteria-6283";
                    IC_X_CFG_SIZE = <0x10>;
                    IC_Y_CFG_SIZE = <0x24>;
                    IC_KEY_CFG_SIZE = <0x4>;
                    X_Channel = <0x10>;
                    Y_Channel = <0x24>;
                    AIN_X = <0x0 0x1 0x2 0x3 0x4 0x5 0x6 0x7 0x8 0x9 0xA 0xB 0xC 0xD 0xE 0xF>;
                    AIN_Y = <0x0 0x1 0x2 0x3 0x4 0x5 0x6 0x7 0x8 0x9 0xA 0xB 0xC 0xD 0xE 0xF 0x10 0x11 0x12 0x13 0x14 0x15 0x16 0x17 0x18 0x19 0x1A 0x1B 0x1C 0x1D 0x1E 0x1F 0x20 0x21 0x22 0x23>;
                    AIN_KEY = <0x0 0x1 0x2 0xFF>;
                    PS_Config_Lmt_Short_Rawdata_P = <0x36B8 0x36B8 0x36B8 0x36B8 0x36B8 0x36B8 0x36B8 0x36B8 0x36B8 0x36B8 0x36B8 0x36B8 0x36B8 0x36B8 0x36B8 0x36B8 0x36B8 0x36B8 0x36B8 0x36B8 0x36B8 0x36B8 0x36B8 0x36B8 0x36B8 0x36B8 0x36B8 0x36B8 0x36B8 0x36B8 0x36B8 0x36B8 0x36B8 0x36B8 0x36B8 0x36B8 0x36B8 0x36B8 0x36B8 0x36B8 0x36B8 0x36B8 0x36B8 0x36B8 0x36B8 0x36B8 0x36B8 0x36B8 0x36B8 0x36B8 0x36B8 0x36B8 0x36B8 0x36B8 0x36B8 0x36B8 0x36B8 0x36B8 0x36B8 0x36B8 0x36B8 0x36B8 0x36B8 0x36B8 0x36B8 0x36B8 0x36B8 0x36B8 0x36B8 0x36B8 0x36B8 0x36B8 0x36B8 0x36B8 0x36B8 0x36B8 0x36B8 0x36B8 0x36B8 0x36B8 0x36B8 0x36B8 0x36B8 0x36B8 0x36B8 0x36B8 0x36B8 0x36B8 0x36B8 0x36B8 0x36B8 0x36B8 0x36B8 0x36B8 0x36B8 0x36B8 0x36B8 0x36B8 0x36B8 0x36B8 0x36B8 0x36B8 0x36B8 0x36B8 0x36B8 0x36B8 0x36B8 0x36B8 0x36B8 0x36B8 0x36B8 0x36B8 0x36B8 0x36B8 0x36B8 0x36B8 0x36B8 0x36B8 0x36B8 0x36B8 0x36B8 0x36B8 0x36B8 0x36B8 0x36B8 0x36B8 0x36B8 0x36B8 0x36B8 0x36B8 0x36B8 0x36B8 0x36B8 0x36B8 0x36B8 0x36B8 0x36B8 0x36B8 0x36B8 0x36B8 0x36B8 0x36B8 0x36B8 0x36B8 0x36B8 0x36B8 0x36B8 0x36B8 0x36B8 0x36B8 0x36B8 0x36B8 0x36B8 0x36B8 0x36B8 0x36B8 0x36B8 0x36B8 0x36B8 0x36B8 0x36B8 0x36B8 0x36B8 0x36B8 0x36B8 0x36B8 0x36B8 0x36B8 0x36B8 0x36B8 0x36B8 0x36B8 0x36B8 0x36B8 0x36B8 0x36B8 0x36B8 0x36B8 0x36B8 0x36B8 0x36B8 0x36B8 0x36B8 0x36B8 0x36B8 0x36B8 0x36B8 0x36B8 0x36B8 0x36B8 0x36B8 0x36B8 0x36B8 0x36B8 0x36B8 0x36B8 0x36B8 0x36B8 0x36B8 0x36B8 0x36B8 0x36B8 0x36B8 0x36B8 0x36B8 0x36B8 0x36B8 0x36B8 0x36B8 0x36B8 0x36B8 0x36B8 0x36B8 0x36B8 0x36B8 0x36B8 0x36B8 0x36B8 0x36B8 0x36B8 0x36B8 0x36B8 0x36B8 0x36B8 0x36B8 0x36B8 0x36B8 0x36B8 0x36B8 0x36B8 0x36B8 0x36B8 0x36B8 0x36B8 0x36B8 0x36B8 0x36B8 0x36B8 0x36B8 0x36B8 0x36B8 0x36B8 0x36B8 0x36B8 0x36B8 0x36B8 0x36B8 0x36B8 0x36B8 0x36B8 0x36B8 0x36B8 0x36B8 0x36B8 0x36B8 0x36B8 0x36B8 0x36B8 0x36B8 0x36B8 0x36B8 0x36B8 0x36B8 0x36B8 0x36B8 0x36B8 0x36B8 0x36B8 0x36B8 0x36B8 0x36B8 0x36B8 0x36B8 0x36B8 0x36B8 0x36B8 0x36B8 0x36B8 0x36B8 0x36B8 0x36B8 0x36B8 0x36B8 0x36B8 0x36B8 0x36B8 0x36B8 0x36B8 0x36B8 0x36B8 0x36B8 0x36B8 0x36B8 0x36B8 0x36B8 0x36B8 0x36B8 0x36B8 0x36B8 0x36B8 0x36B8 0x36B8 0x36B8 0x36B8 0x36B8 0x36B8 0x36B8 0x36B8 0x36B8 0x36B8 0x36B8 0x36B8 0x36B8 0x36B8 0x36B8 0x36B8 0x36B8 0x36B8 0x36B8 0x36B8 0x36B8 0x36B8 0x36B8 0x36B8 0x36B8 0x36B8 0x36B8 0x36B8 0x36B8 0x36B8 0x36B8 0x36B8 0x36B8 0x36B8 0x36B8 0x36B8 0x36B8 0x36B8 0x36B8 0x36B8 0x36B8 0x36B8 0x36B8 0x36B8 0x36B8 0x36B8 0x36B8 0x36B8 0x36B8 0x36B8 0x36B8 0x36B8 0x36B8 0x36B8 0x36B8 0x36B8 0x36B8 0x36B8 0x36B8 0x36B8 0x36B8 0x36B8 0x36B8 0x36B8 0x36B8 0x36B8 0x36B8 0x36B8 0x36B8 0x36B8 0x36B8 0x36B8 0x36B8 0x36B8 0x36B8 0x36B8 0x36B8 0x36B8 0x36B8 0x36B8 0x36B8 0x36B8 0x36B8 0x36B8 0x36B8 0x36B8 0x36B8 0x36B8 0x36B8 0x36B8 0x36B8 0x36B8 0x36B8 0x36B8 0x36B8 0x36B8 0x36B8 0x36B8 0x36B8 0x36B8 0x36B8 0x36B8 0x36B8 0x36B8 0x36B8 0x36B8 0x36B8 0x36B8 0x36B8 0x36B8 0x36B8 0x36B8 0x36B8 0x36B8 0x36B8 0x36B8 0x36B8 0x36B8 0x36B8 0x36B8 0x36B8 0x36B8 0x36B8 0x36B8 0x36B8 0x36B8 0x36B8 0x36B8 0x36B8 0x36B8 0x36B8 0x36B8 0x36B8 0x36B8 0x36B8 0x36B8 0x36B8 0x36B8 0x36B8 0x36B8 0x36B8 0x36B8 0x36B8 0x36B8 0x36B8 0x36B8 0x36B8 0x36B8 0x36B8 0x36B8 0x36B8 0x36B8 0x36B8 0x36B8 0x36B8 0x36B8 0x36B8 0x36B8 0x36B8 0x36B8 0x36B8 0x36B8 0x36B8 0x36B8 0x36B8 0x36B8 0x36B8 0x36B8 0x36B8 0x36B8 0x36B8 0x36B8 0x36B8 0x36B8 0x36B8 0x36B8 0x36B8 0x36B8 0x36B8 0x36B8 0x36B8 0x36B8 0x36B8 0x36B8 0x36B8 0x36B8 0x36B8 0x36B8 0x36B8 0x36B8 0x36B8 0x36B8 0x36B8 0x36B8 0x36B8 0x36B8 0x36B8 0x36B8 0x36B8 0x36B8 0x36B8 0x36B8 0x36B8 0x36B8 0x36B8 0x36B8 0x36B8 0x36B8 0x36B8 0x36B8 0x36B8 0x36B8 0x36B8 0x36B8 0x36B8 0x36B8 0x36B8 0x36B8 0x36B8 0x36B8 0x36B8 0x36B8 0x36B8 0x36B8 0x36B8 0x36B8 0x36B8 0x36B8 0x36B8 0x36B8 0x36B8 0x36B8 0x36B8 0x36B8 0x36B8 0x36B8 0x36B8 0x36B8 0x36B8 0x36B8 0x36B8 0x36B8 0x36B8 0x36B8 0x36B8 0x36B8 0x36B8 0x36B8 0x36B8 0x36B8 0x36B8 0x36B8 0x36B8 0x36B8 0x36B8 0x36B8 0x36B8 0x36B8 0x36B8 0x36B8 0x36B8 0x36B8 0x36B8 0x36B8 0x36B8 0x36B8 0x36B8 0x36B8 0x36B8 0x36B8 0x36B8 0x36B8 0x36B8 0x36B8 0x36B8 0x36B8 0x36B8 0x36B8 0x36B8>;
                    PS_Config_Lmt_Short_Rawdata_N = <0x2774 0x2774 0x2774 0x2774 0x2774 0x2774 0x2774 0x2774 0x2774 0x2774 0x2774 0x2774 0x2774 0x2774 0x2774 0x2774 0x2774 0x2774 0x2774 0x2774 0x2774 0x2774 0x2774 0x2774 0x2774 0x2774 0x2774 0x2774 0x2774 0x2774 0x2774 0x2774 0x2774 0x2774 0x2774 0x2774 0x2774 0x2774 0x2774 0x2774 0x2774 0x2774 0x2774 0x2774 0x2774 0x2774 0x2774 0x2774 0x2774 0x2774 0x2774 0x2774 0x2774 0x2774 0x2774 0x2774 0x2774 0x2774 0x2774 0x2774 0x2774 0x2774 0x2774 0x2774 0x2774 0x2774 0x2774 0x2774 0x2774 0x2774 0x2774 0x2774 0x2774 0x2774 0x2774 0x2774 0x2774 0x2774 0x2774 0x2774 0x2774 0x2774 0x2774 0x2774 0x2774 0x2774 0x2774 0x2774 0x2774 0x2774 0x2774 0x2774 0x2774 0x2774 0x2774 0x2774 0x2774 0x2774 0x2774 0x2774 0x2774 0x2774 0x2774 0x2774 0x2774 0x2774 0x2774 0x2774 0x2774 0x2774 0x2774 0x2774 0x2774 0x2774 0x2774 0x2774 0x2774 0x2774 0x2774 0x2774 0x2774 0x2774 0x2774 0x2774 0x2774 0x2774 0x2774 0x2774 0x2774 0x2774 0x2774 0x2774 0x2774 0x2774 0x2774 0x2774 0x2774 0x2774 0x2774 0x2774 0x2774 0x2774 0x2774 0x2774 0x2774 0x2774 0x2774 0x2774 0x2774 0x2774 0x2774 0x2774 0x2774 0x2774 0x2774 0x2774 0x2774 0x2774 0x2774 0x2774 0x2774 0x2774 0x2774 0x2774 0x2774 0x2774 0x2774 0x2774 0x2774 0x2774 0x2774 0x2774 0x2774 0x2774 0x2774 0x2774 0x2774 0x2774 0x2774 0x2774 0x2774 0x2774 0x2774 0x2774 0x2774 0x2774 0x2774 0x2774 0x2774 0x2774 0x2774 0x2774 0x2774 0x2774 0x2774 0x2774 0x2774 0x2774 0x2774 0x2774 0x2774 0x2774 0x2774 0x2774 0x2774 0x2774 0x2774 0x2774 0x2774 0x2774 0x2774 0x2774 0x2774 0x2774 0x2774 0x2774 0x2774 0x2774 0x2774 0x2774 0x2774 0x2774 0x2774 0x2774 0x2774 0x2774 0x2774 0x2774 0x2774 0x2774 0x2774 0x2774 0x2774 0x2774 0x2774 0x2774 0x2774 0x2774 0x2774 0x2774 0x2774 0x2774 0x2774 0x2774 0x2774 0x2774 0x2774 0x2774 0x2774 0x2774 0x2774 0x2774 0x2774 0x2774 0x2774 0x2774 0x2774 0x2774 0x2774 0x2774 0x2774 0x2774 0x2774 0x2774 0x2774 0x2774 0x2774 0x2774 0x2774 0x2774 0x2774 0x2774 0x2774 0x2774 0x2774 0x2774 0x2774 0x2774 0x2774 0x2774 0x2774 0x2774 0x2774 0x2774 0x2774 0x2774 0x2774 0x2774 0x2774 0x2774 0x2774 0x2774 0x2774 0x2774 0x2774 0x2774 0x2774 0x2774 0x2774 0x2774 0x2774 0x2774 0x2774 0x2774 0x2774 0x2774 0x2774 0x2774 0x2774 0x2774 0x2774 0x2774 0x2774 0x2774 0x2774 0x2774 0x2774 0x2774 0x2774 0x2774 0x2774 0x2774 0x2774 0x2774 0x2774 0x2774 0x2774 0x2774 0x2774 0x2774 0x2774 0x2774 0x2774 0x2774 0x2774 0x2774 0x2774 0x2774 0x2774 0x2774 0x2774 0x2774 0x2774 0x2774 0x2774 0x2774 0x2774 0x2774 0x2774 0x2774 0x2774 0x2774 0x2774 0x2774 0x2774 0x2774 0x2774 0x2774 0x2774 0x2774 0x2774 0x2774 0x2774 0x2774 0x2774 0x2774 0x2774 0x2774 0x2774 0x2774 0x2774 0x2774 0x2774 0x2774 0x2774 0x2774 0x2774 0x2774 0x2774 0x2774 0x2774 0x2774 0x2774 0x2774 0x2774 0x2774 0x2774 0x2774 0x2774 0x2774 0x2774 0x2774 0x2774 0x2774 0x2774 0x2774 0x2774 0x2774 0x2774 0x2774 0x2774 0x2774 0x2774 0x2774 0x2774 0x2774 0x2774 0x2774 0x2774 0x2774 0x2774 0x2774 0x2774 0x2774 0x2774 0x2774 0x2774 0x2774 0x2774 0x2774 0x2774 0x2774 0x2774 0x2774 0x2774 0x2774 0x2774 0x2774 0x2774 0x2774 0x2774 0x2774 0x2774 0x2774 0x2774 0x2774 0x2774 0x2774 0x2774 0x2774 0x2774 0x2774 0x2774 0x2774 0x2774 0x2774 0x2774 0x2774 0x2774 0x2774 0x2774 0x2774 0x2774 0x2774 0x2774 0x2774 0x2774 0x2774 0x2774 0x2774 0x2774 0x2774 0x2774 0x2774 0x2774 0x2774 0x2774 0x2774 0x2774 0x2774 0x2774 0x2774 0x2774 0x2774 0x2774 0x2774 0x2774 0x2774 0x2774 0x2774 0x2774 0x2774 0x2774 0x2774 0x2774 0x2774 0x2774 0x2774 0x2774 0x2774 0x2774 0x2774 0x2774 0x2774 0x2774 0x2774 0x2774 0x2774 0x2774 0x2774 0x2774 0x2774 0x2774 0x2774 0x2774 0x2774 0x2774 0x2774 0x2774 0x2774 0x2774 0x2774 0x2774 0x2774 0x2774 0x2774 0x2774 0x2774 0x2774 0x2774 0x2774 0x2774 0x2774 0x2774 0x2774 0x2774 0x2774 0x2774 0x2774 0x2774 0x2774 0x2774 0x2774 0x2774 0x2774 0x2774 0x2774 0x2774 0x2774 0x2774 0x2774 0x2774 0x2774 0x2774 0x2774 0x2774 0x2774 0x2774 0x2774 0x2774 0x2774 0x2774 0x2774 0x2774 0x2774 0x2774 0x2774 0x2774 0x2774 0x2774 0x2774 0x2774 0x2774 0x2774 0x2774 0x2774 0x2774 0x2774 0x2774 0x2774 0x2774 0x2774 0x2774 0x2774 0x2774 0x2774 0x2710 0x2710 0x2710>;
                    PS_Config_Lmt_Open_Rawdata_P = <0xDB4 0xE82 0xEA6 0xEF0 0xEA9 0xEC9 0xEB7 0xDCF 0xDED 0xF13 0xED7 0xEEB 0xEE8 0xED2 0xE66 0xDA9 0xDE8 0xE9C 0xEC1 0xF0B 0xECB 0xEE8 0xEC9 0xE1C 0xDF6 0xEE5 0xEAA 0xEC1 0xEB7 0xE9E 0xE36 0xDA9 0xE5D 0xEAA 0xECD 0xF2E 0xEF0 0xF00 0xEE0 0xEDD 0xEF7 0xF2E 0xEF7 0xF11 0xF11 0xED7 0xE7B 0xE3C 0xE67 0xEAD 0xED0 0xF35 0xEF0 0xEFD 0xEDE 0xEC5 0xF03 0xF3F 0xF05 0xF20 0xF13 0xEE2 0xE80 0xE38 0xE80 0xECD 0xEE2 0xF4D 0xF13 0xF28 0xEF7 0xF00 0xEFA 0xF3B 0xEF2 0xF15 0xEFA 0xEC2 0xE62 0xE3A 0xE74 0xEBF 0xED6 0xF46 0xF12 0xF2E 0xEF5 0xF0A 0xF24 0xF5F 0xF13 0xF3B 0xF1A 0xEE1 0xE87 0xE60 0xE9C 0xEE8 0xF0B 0xF6E 0xF46 0xF63 0xF28 0xF36 0xF47 0xF81 0xF3F 0xF54 0xF26 0xEFD 0xE95 0xE75 0xE9E 0xEEE 0xF16 0xF6D 0xF59 0xF7A 0xF21 0xF4A 0xF50 0xF7F 0xF43 0xF5C 0xF21 0xEF2 0xE7B 0xE6D 0xEC2 0xF0C 0xF2B 0xF88 0xF82 0xF97 0xF66 0xF6A 0xF83 0xFA8 0xF6E 0xF8A 0xF3D 0xF0E 0xEBA 0xE8C 0xED0 0xF15 0xF32 0xF98 0xF94 0xFA8 0xF7B 0xF78 0xF85 0xFA8 0xF6A 0xF8C 0xF35 0xF03 0xEAD 0xE7F 0xED7 0xF2F 0xF42 0xFB0 0xFB2 0xFB9 0xF9A 0xFAC 0xF86 0xFBA 0xF74 0xF9F 0xF2D 0xEEF 0xEAC 0xE86 0xED0 0xF2D 0xF34 0xFA1 0xFA5 0xFC9 0xF96 0xF9F 0xF98 0xFC9 0xF86 0xFB6 0xF42 0xF20 0xEC4 0xE9E 0xEE2 0xF32 0xF49 0xFAB 0xFC9 0xFF5 0xFBA 0xFB6 0xFB6 0xFE3 0xFAB 0xFC5 0xF4E 0xF34 0xED2 0xEA1 0xEF9 0xF4D 0xF69 0xFC4 0xFEC 0x101F 0xFE3 0xFD3 0xFC8 0xFF1 0xFBA 0xFDE 0xF4D 0xF3B 0xEE0 0xEAC 0xF11 0xF62 0xF7A 0xFD5 0xFEB 0x1037 0x1004 0xFEE 0xFE7 0x1003 0xFC1 0xFE8 0xF43 0xF36 0xEE1 0xEA3 0xF0F 0xF62 0xF70 0xFC5 0x1003 0x1034 0x100D 0xFFF 0xFF5 0x100D 0xFD2 0xFF5 0xF60 0xF3C 0xEE5 0xEA6 0xF18 0xF6E 0xF6D 0xFC7 0x100B 0x104D 0x1024 0x1011 0x100F 0x1034 0xFEB 0x1014 0xF70 0xF50 0xEE8 0xEB7 0xF08 0xF63 0xF50 0xFA2 0xFFA 0x1037 0x101B 0x1006 0x1001 0x1023 0xFDD 0xFF3 0xF65 0xF46 0xED4 0xEAD 0xEC4 0xEC8 0xE9F 0xE95 0xE60 0xE8A 0xE80 0xEB0 0xE21 0xE86 0xE51 0xE4E 0xE63 0xEBB 0xEC9 0xF2A 0xEC9 0xED4 0xE9A 0xE9F 0xE67 0xE90 0xE82 0xEB4 0xE3A 0xE97 0xE70 0xE80 0xE87 0xEDB 0xEE8 0xF43 0xEBF 0xEDA 0xE9F 0xEA6 0xE6E 0xE94 0xE89 0xEB4 0xE62 0xEAC 0xE95 0xEA8 0xEA9 0xF04 0xF03 0xF40 0xECC 0xEE7 0xE9B 0xEB8 0xE78 0xE9C 0xE98 0xEB7 0xE36 0xE8C 0xE67 0xE97 0xE97 0xEEB 0xEE5 0xF23 0xEE7 0xF0E 0xECD 0xED7 0xEA5 0xEC1 0xEB7 0xED7 0xE47 0xE9A 0xE82 0xEB1 0xEAC 0xEF0 0xEEB 0xF1F 0xED6 0xF07 0xEC6 0xEDA 0xE9B 0xEB6 0xEAF 0xED3 0xE69 0xEAC 0xE9C 0xECC 0xEC4 0xF04 0xF03 0xF2A 0xEB8 0xEF6 0xEB8 0xEC5 0xE8C 0xEA8 0xE9B 0xEBA 0xE74 0xEBA 0xEA6 0xED3 0xED0 0xF1C 0xF13 0xF36 0xEC9 0xEFE 0xED2 0xEDD 0xEA3 0xECB 0xEB8 0xEDA 0xE7C 0xEA5 0xEA9 0xED4 0xED3 0xF19 0xF0E 0xF1F 0xEBD 0xF04 0xECF 0xED7 0xE9E 0xEB8 0xEB7 0xED3 0xE71 0xEB0 0xEA9 0xED0 0xED4 0xF13 0xF18 0xF12 0xEBB 0xF0A 0xED6 0xED9 0xEA8 0xEC4 0xEBF 0xED7 0xE64 0xE9F 0xE93 0xEBE 0xEB6 0xF00 0xEFC 0xEF5 0xEBA 0xF2D 0xEE8 0xF00 0xEBD 0xEDD 0xED6 0xEF0 0xE83 0xED4 0xEBE 0xEF5 0xEE9 0xF31 0xF28 0xF13 0xEB3 0xF0F 0xED4 0xEEC 0xEAA 0xEC6 0xEC6 0xED9 0xE85 0xEC6 0xEA8 0xEDA 0xED6 0xF19 0xF0B 0xEF7 0xEB1 0xF1A 0xEF0 0xEFD 0xEBB 0xEE2 0xED9 0xEE8 0xE75 0xEB8 0xEAC 0xECC 0xEC6 0xF15 0xEEC 0xEDD 0xD89 0xEF9 0xDB8 0xEE5 0xD92 0xED6 0xDA7 0xED2 0xD6A 0xEC1 0xD91 0xED4 0xDB1 0xF1A 0xDCF 0xEE0 0xD8A 0xDCC 0xDBE 0xDD0 0xD9C 0xDC2 0xDB1 0xDBF 0xD80 0xDB7 0xD9E 0xDC5 0xDBF 0xDFA 0xDD3 0xDCC 0xDC3 0xE07 0xE01 0xE15 0xDDE 0xE02 0xDF3 0xE02 0xDAE 0xDE8 0xDC8 0xDF0 0xDE5 0xE20 0xDF0 0xDE6 0xCE8 0xE13 0xE0C 0xE24 0xDEC 0xE13 0xE00 0xE13 0xDB3 0xDFA 0xDCA 0xDFB 0xDEC 0xE2B 0xDED 0xD04 0xCAE 0xE25 0xE20 0xE48 0xE05 0xE2A 0xE15 0xE2C 0xDC8 0xE15 0xDE4 0xE0F 0xE0C 0xE41 0xDF9 0xCCC 0x1400 0x1400 0x1400>;
                    PS_Config_Lmt_Open_Rawdata_N = <0x5DF 0x637 0x647 0x667 0x648 0x656 0x64E 0x5EB 0x5F8 0x676 0x65C 0x664 0x663 0x65A 0x62B 0x5DA 0x5F5 0x643 0x652 0x672 0x657 0x663 0x656 0x60C 0x5FB 0x662 0x649 0x652 0x64E 0x643 0x617 0x5DA 0x628 0x649 0x658 0x681 0x667 0x66D 0x660 0x65E 0x66A 0x681 0x66A 0x675 0x675 0x65C 0x634 0x619 0x62C 0x64A 0x659 0x684 0x667 0x66C 0x65F 0x654 0x66F 0x688 0x670 0x67B 0x676 0x661 0x637 0x618 0x637 0x658 0x661 0x68E 0x676 0x67F 0x66A 0x66D 0x66B 0x687 0x667 0x676 0x66B 0x653 0x62A 0x619 0x631 0x652 0x65B 0x68B 0x675 0x681 0x669 0x672 0x67D 0x696 0x676 0x687 0x679 0x660 0x63A 0x629 0x643 0x663 0x672 0x69D 0x68B 0x698 0x67F 0x685 0x68C 0x6A5 0x688 0x691 0x67E 0x66C 0x640 0x632 0x643 0x666 0x677 0x69C 0x694 0x6A2 0x67C 0x68D 0x690 0x6A4 0x68A 0x695 0x67C 0x667 0x634 0x62E 0x653 0x673 0x680 0x6A8 0x6A5 0x6AE 0x699 0x69B 0x6A6 0x6B5 0x69D 0x6A9 0x688 0x673 0x64F 0x63C 0x659 0x676 0x683 0x6AF 0x6AD 0x6B5 0x6A2 0x6A1 0x6A6 0x6B5 0x69B 0x6A9 0x684 0x66F 0x64A 0x636 0x65C 0x682 0x68A 0x6B9 0x6BA 0x6BD 0x6AF 0x6B7 0x6A7 0x6BD 0x69F 0x6B2 0x681 0x666 0x649 0x639 0x659 0x681 0x684 0x6B2 0x6B4 0x6C4 0x6AE 0x6B2 0x6AF 0x6C4 0x6A7 0x6BB 0x68A 0x67B 0x654 0x643 0x661 0x683 0x68D 0x6B7 0x6C4 0x6D6 0x6BD 0x6BB 0x6BB 0x6CF 0x6B7 0x6C2 0x68F 0x684 0x65A 0x645 0x66A 0x68E 0x69A 0x6C1 0x6D3 0x6E8 0x6CF 0x6C8 0x6C3 0x6D5 0x6BD 0x6CD 0x68E 0x687 0x660 0x649 0x675 0x697 0x6A2 0x6C9 0x6D2 0x6F3 0x6DD 0x6D3 0x6D0 0x6DC 0x6C0 0x6D1 0x68A 0x685 0x660 0x646 0x674 0x697 0x69D 0x6C2 0x6DC 0x6F1 0x6E1 0x6DB 0x6D6 0x6E1 0x6C7 0x6D6 0x697 0x687 0x662 0x647 0x678 0x69D 0x69C 0x6C3 0x6E0 0x6FC 0x6EB 0x6E2 0x6E2 0x6F1 0x6D2 0x6E4 0x69D 0x690 0x663 0x64E 0x671 0x698 0x690 0x6B3 0x6D9 0x6F3 0x6E7 0x6DE 0x6DC 0x6EA 0x6CC 0x6D6 0x699 0x68B 0x65B 0x64A 0x654 0x655 0x644 0x640 0x629 0x63B 0x637 0x64B 0x60E 0x639 0x622 0x621 0x62A 0x650 0x656 0x67F 0x656 0x65B 0x642 0x644 0x62C 0x63D 0x637 0x64D 0x619 0x640 0x630 0x637 0x63A 0x65E 0x663 0x68A 0x652 0x65D 0x644 0x647 0x62F 0x63F 0x63A 0x64D 0x62A 0x649 0x640 0x648 0x648 0x66F 0x66F 0x689 0x657 0x663 0x642 0x64F 0x633 0x643 0x641 0x64E 0x617 0x63C 0x62C 0x640 0x640 0x664 0x662 0x67C 0x663 0x673 0x658 0x65C 0x646 0x652 0x64E 0x65C 0x61E 0x642 0x637 0x64C 0x649 0x667 0x664 0x67B 0x65B 0x670 0x655 0x65D 0x642 0x64E 0x64B 0x65A 0x62D 0x649 0x643 0x657 0x654 0x66F 0x66F 0x67F 0x64F 0x669 0x64F 0x654 0x63C 0x648 0x642 0x64F 0x631 0x64F 0x647 0x65A 0x659 0x679 0x676 0x685 0x656 0x66D 0x65A 0x65E 0x646 0x657 0x64F 0x65D 0x635 0x646 0x648 0x65B 0x65A 0x678 0x673 0x67B 0x651 0x66F 0x658 0x65C 0x643 0x64F 0x64E 0x65A 0x630 0x64B 0x648 0x659 0x65B 0x676 0x678 0x675 0x650 0x672 0x65B 0x65D 0x648 0x654 0x652 0x65C 0x62B 0x644 0x63F 0x651 0x64E 0x66D 0x66C 0x669 0x64F 0x681 0x663 0x66D 0x651 0x65E 0x65B 0x667 0x638 0x65B 0x651 0x669 0x664 0x682 0x67F 0x676 0x64C 0x674 0x65B 0x665 0x649 0x655 0x655 0x65D 0x639 0x655 0x648 0x65D 0x65B 0x678 0x672 0x66A 0x64C 0x679 0x667 0x66C 0x650 0x661 0x65D 0x663 0x632 0x64F 0x649 0x657 0x655 0x676 0x665 0x65E 0x5CD 0x66A 0x5E1 0x662 0x5D1 0x65B 0x5DA 0x65A 0x5BF 0x652 0x5D0 0x65B 0x5DE 0x679 0x5EB 0x660 0x5CD 0x5E9 0x5E3 0x5EB 0x5D5 0x5E5 0x5DE 0x5E4 0x5C9 0x5E0 0x5D6 0x5E6 0x5E4 0x5FD 0x5EC 0x5E9 0x5E6 0x603 0x600 0x609 0x5F1 0x601 0x5FA 0x601 0x5DD 0x5F5 0x5E8 0x5F9 0x5F4 0x60D 0x5F9 0x5F5 0x588 0x608 0x605 0x60F 0x5F7 0x608 0x600 0x608 0x5DF 0x5FD 0x5E9 0x5FE 0x5F7 0x612 0x5F8 0x594 0x56F 0x610 0x60D 0x61F 0x602 0x612 0x609 0x613 0x5E8 0x609 0x5F4 0x606 0x605 0x61C 0x5FD 0x57C 0xFFFFFE01 0xFFFFFE01 0xFFFFFE01>;
                    PS_Config_Lmt_FW_Rawdata_P = <0x464 0x469 0x465 0x468 0x46C 0x468 0x465 0x469 0x46E 0x468 0x460 0x46E 0x465 0x469 0x464 0x46B 0x472 0x472 0x462 0x464 0x45D 0x464 0x461 0x467 0x460 0x45E 0x45A 0x45E 0x461 0x45E 0x462 0x467 0x461 0x461 0x460 0x45D 0x468 0x469 0x469 0x46E 0x456 0x452 0x44F 0x454 0x45A 0x45E 0x45A 0x465 0x46E 0x464 0x45E 0x459 0x464 0x465 0x460 0x460 0x461 0x462 0x461 0x468 0x46B 0x465 0x469 0x45A 0x44C 0x473 0x473 0x472 0x45A 0x45D 0x453 0x45B 0x45D 0x45E 0x45E 0x468 0x460 0x464 0x464 0x461 0x465 0x467 0x46C 0x46B 0x456 0x465 0x456 0x470 0x45D 0x464 0x461 0x465 0x462 0x452 0x44C 0x456 0x465 0x457 0x457 0x45D 0x454 0x452 0x456 0x457 0x456 0x45A 0x461 0x45B 0x45E 0x45E 0x462 0x45D 0x462 0x467 0x469 0x460 0x464 0x467 0x45A 0x467 0x460 0x45A 0x464 0x460 0x45E 0x461 0x461 0x462 0x452 0x45B 0x45B 0x45E 0x459 0x45B 0x45D 0x45D 0x464 0x45E 0x453 0x454 0x454 0x45A 0x456 0x467 0x46C 0x469 0x467 0x465 0x460 0x465 0x459 0x462 0x457 0x456 0x457 0x45A 0x45D 0x457 0x459 0x46C 0x45E 0x45E 0x44C 0x450 0x467 0x44D 0x46B 0x453 0x465 0x465 0x462 0x461 0x464 0x464 0x45E 0x46F 0x46E 0x473 0x475 0x472 0x467 0x476 0x46B 0x44D 0x44D 0x44F 0x44F 0x450 0x452 0x454 0x454 0x468 0x456 0x460 0x45E 0x46B 0x465 0x467 0x462 0x45D 0x467 0x464 0x462 0x460 0x461 0x460 0x45A 0x46B 0x45B 0x45A 0x45E 0x462 0x452 0x462 0x45D 0x45D 0x460 0x45D 0x457 0x457 0x459 0x457 0x459 0x457 0x45D 0x454 0x45B 0x45E 0x459 0x45E 0x457 0x460 0x459 0x457 0x467 0x459 0x464 0x461 0x45D 0x465 0x473 0x459 0x453 0x45B 0x45A 0x462 0x460 0x454 0x450 0x459 0x44F 0x44B 0x44C 0x449 0x452 0x47D 0x45B 0x460 0x464 0x465 0x462 0x465 0x464 0x46B 0x456 0x465 0x465 0x459 0x45D 0x45D 0x45B 0x45B 0x462 0x45B 0x467 0x46E 0x46E 0x472 0x472 0x462 0x45E 0x456 0x454 0x45B 0x459 0x459 0x456 0x464 0x45E 0x45A 0x452 0x45B 0x452 0x450 0x456 0x45B 0x45A 0x44D 0x45B 0x45A 0x45D 0x45E 0x459 0x46E 0x47E 0x456 0x457 0x457 0x45D 0x456 0x45B 0x454 0x45A 0x45E 0x460 0x467 0x45D 0x459 0x45A 0x45D 0x465 0x45B 0x456 0x462 0x44C 0x452 0x45A 0x459 0x467 0x467 0x465 0x460 0x462 0x467 0x460 0x465 0x461 0x45B 0x45D 0x45B 0x468 0x461 0x45A 0x45B 0x45D 0x469 0x469 0x461 0x469 0x46C 0x472 0x45E 0x45D 0x468 0x467 0x469 0x467 0x468 0x468 0x465 0x461 0x45D 0x45B 0x454 0x45B 0x462 0x459 0x45A 0x45B 0x465 0x462 0x45B 0x468 0x460 0x460 0x464 0x460 0x454 0x452 0x45A 0x454 0x453 0x450 0x469 0x46E 0x45D 0x459 0x45B 0x453 0x44F 0x45B 0x456 0x461 0x462 0x462 0x457 0x464 0x45A 0x45A 0x464 0x46B 0x453 0x459 0x459 0x45E 0x45A 0x460 0x457 0x457 0x457 0x462 0x462 0x461 0x44F 0x456 0x464 0x442 0x479 0x475 0x473 0x464 0x462 0x470 0x470 0x461 0x462 0x45D 0x460 0x462 0x464 0x468 0x467 0x44D 0x468 0x461 0x460 0x468 0x45B 0x462 0x468 0x459 0x456 0x457 0x450 0x457 0x45E 0x45B 0x468 0x461 0x45A 0x453 0x453 0x450 0x453 0x452 0x450 0x452 0x44D 0x44F 0x452 0x450 0x461 0x462 0x452 0x469 0x45E 0x46B 0x468 0x46C 0x464 0x464 0x461 0x456 0x45E 0x45E 0x45B 0x462 0x457 0x456 0x46B 0x476 0x45A 0x45E 0x45E 0x46F 0x464 0x469 0x465 0x464 0x461 0x46E 0x46E 0x46B 0x465 0x468 0x456 0x467 0x469 0x465 0x45B 0x464 0x459 0x45B 0x45B 0x45A 0x461 0x460 0x465 0x469 0x469 0x464 0x45E 0x46C 0x44B 0x453 0x454 0x450 0x45A 0x462 0x45B 0x467 0x465 0x461 0x46B 0x461 0x46C 0x465 0x45D 0x467 0x461 0x459 0x462 0x45E 0x461 0x465 0x454 0x464 0x450 0x453 0x45A 0x45B 0x453 0x45A 0x459 0x44D 0x452 0x453 0x45A 0x462 0x460 0x464 0x45D 0x457 0x456 0x457 0x459 0x456 0x44D 0x456 0x464 0x462 0x468 0x467 0x461 0x468 0x464 0x46C 0x465 0x462 0x45D 0x45E 0x460 0x459 0x45B 0x452 0x459 0xF00 0xF00 0xF00>;
                    PS_Config_Lmt_FW_Rawdata_N = <0x1E1 0x1E4 0x1E2 0x1E3 0x1E5 0x1E3 0x1E2 0x1E4 0x1E6 0x1E3 0x1E0 0x1E6 0x1E2 0x1E4 0x1E1 0x1E4 0x1E7 0x1E7 0x1E1 0x1E1 0x1DE 0x1E1 0x1E0 0x1E3 0x1E0 0x1DF 0x1DD 0x1DF 0x1E0 0x1DF 0x1E1 0x1E3 0x1E0 0x1E0 0x1E0 0x1DE 0x1E3 0x1E4 0x1E4 0x1E6 0x1DB 0x1DA 0x1D8 0x1DB 0x1DD 0x1DF 0x1DD 0x1E2 0x1E6 0x1E1 0x1DF 0x1DD 0x1E1 0x1E2 0x1E0 0x1E0 0x1E0 0x1E1 0x1E0 0x1E3 0x1E4 0x1E2 0x1E4 0x1DD 0x1D7 0x1E8 0x1E8 0x1E7 0x1DD 0x1DE 0x1DA 0x1DE 0x1DE 0x1DF 0x1DF 0x1E3 0x1E0 0x1E1 0x1E1 0x1E0 0x1E2 0x1E3 0x1E5 0x1E4 0x1DB 0x1E2 0x1DB 0x1E7 0x1DE 0x1E1 0x1E0 0x1E2 0x1E1 0x1DA 0x1D7 0x1DB 0x1E2 0x1DC 0x1DC 0x1DE 0x1DB 0x1DA 0x1DB 0x1DC 0x1DB 0x1DD 0x1E0 0x1DE 0x1DF 0x1DF 0x1E1 0x1DE 0x1E1 0x1E3 0x1E4 0x1E0 0x1E1 0x1E3 0x1DD 0x1E3 0x1E0 0x1DD 0x1E1 0x1E0 0x1DF 0x1E0 0x1E0 0x1E1 0x1DA 0x1DE 0x1DE 0x1DF 0x1DD 0x1DE 0x1DE 0x1DE 0x1E1 0x1DF 0x1DA 0x1DB 0x1DB 0x1DD 0x1DB 0x1E3 0x1E5 0x1E4 0x1E3 0x1E2 0x1E0 0x1E2 0x1DD 0x1E1 0x1DC 0x1DB 0x1DC 0x1DD 0x1DE 0x1DC 0x1DD 0x1E5 0x1DF 0x1DF 0x1D7 0x1D9 0x1E3 0x1D8 0x1E4 0x1DA 0x1E2 0x1E2 0x1E1 0x1E0 0x1E1 0x1E1 0x1DF 0x1E6 0x1E6 0x1E8 0x1E9 0x1E7 0x1E3 0x1E9 0x1E4 0x1D8 0x1D8 0x1D8 0x1D8 0x1D9 0x1DA 0x1DB 0x1DB 0x1E3 0x1DB 0x1E0 0x1DF 0x1E4 0x1E2 0x1E3 0x1E1 0x1DE 0x1E3 0x1E1 0x1E1 0x1E0 0x1E0 0x1E0 0x1DD 0x1E4 0x1DE 0x1DD 0x1DF 0x1E1 0x1DA 0x1E1 0x1DE 0x1DE 0x1E0 0x1DE 0x1DC 0x1DC 0x1DD 0x1DC 0x1DD 0x1DC 0x1DE 0x1DB 0x1DE 0x1DF 0x1DD 0x1DF 0x1DC 0x1E0 0x1DD 0x1DC 0x1E3 0x1DD 0x1E1 0x1E0 0x1DE 0x1E2 0x1E8 0x1DD 0x1DA 0x1DE 0x1DD 0x1E1 0x1E0 0x1DB 0x1D9 0x1DD 0x1D8 0x1D7 0x1D7 0x1D6 0x1DA 0x1EC 0x1DE 0x1E0 0x1E1 0x1E2 0x1E1 0x1E2 0x1E1 0x1E4 0x1DB 0x1E2 0x1E2 0x1DD 0x1DE 0x1DE 0x1DE 0x1DE 0x1E1 0x1DE 0x1E3 0x1E6 0x1E6 0x1E7 0x1E7 0x1E1 0x1DF 0x1DB 0x1DB 0x1DE 0x1DD 0x1DD 0x1DB 0x1E1 0x1DF 0x1DD 0x1DA 0x1DE 0x1DA 0x1D9 0x1DB 0x1DE 0x1DD 0x1D8 0x1DE 0x1DD 0x1DE 0x1DF 0x1DD 0x1E6 0x1ED 0x1DB 0x1DC 0x1DC 0x1DE 0x1DB 0x1DE 0x1DB 0x1DD 0x1DF 0x1E0 0x1E3 0x1DE 0x1DD 0x1DD 0x1DE 0x1E2 0x1DE 0x1DB 0x1E1 0x1D7 0x1DA 0x1DD 0x1DD 0x1E3 0x1E3 0x1E2 0x1E0 0x1E1 0x1E3 0x1E0 0x1E2 0x1E0 0x1DE 0x1DE 0x1DE 0x1E3 0x1E0 0x1DD 0x1DE 0x1DE 0x1E4 0x1E4 0x1E0 0x1E4 0x1E5 0x1E7 0x1DF 0x1DE 0x1E3 0x1E3 0x1E4 0x1E3 0x1E3 0x1E3 0x1E2 0x1E0 0x1DE 0x1DE 0x1DB 0x1DE 0x1E1 0x1DD 0x1DD 0x1DE 0x1E2 0x1E1 0x1DE 0x1E3 0x1E0 0x1E0 0x1E1 0x1E0 0x1DB 0x1DA 0x1DD 0x1DB 0x1DA 0x1D9 0x1E4 0x1E6 0x1DE 0x1DD 0x1DE 0x1DA 0x1D8 0x1DE 0x1DB 0x1E0 0x1E1 0x1E1 0x1DC 0x1E1 0x1DD 0x1DD 0x1E1 0x1E4 0x1DA 0x1DD 0x1DD 0x1DF 0x1DD 0x1E0 0x1DC 0x1DC 0x1DC 0x1E1 0x1E1 0x1E0 0x1D8 0x1DB 0x1E1 0x1D3 0x1EA 0x1E9 0x1E8 0x1E1 0x1E1 0x1E7 0x1E7 0x1E0 0x1E1 0x1DE 0x1E0 0x1E1 0x1E1 0x1E3 0x1E3 0x1D8 0x1E3 0x1E0 0x1E0 0x1E3 0x1DE 0x1E1 0x1E3 0x1DD 0x1DB 0x1DC 0x1D9 0x1DC 0x1DF 0x1DE 0x1E3 0x1E0 0x1DD 0x1DA 0x1DA 0x1D9 0x1DA 0x1DA 0x1D9 0x1DA 0x1D8 0x1D8 0x1DA 0x1D9 0x1E0 0x1E1 0x1DA 0x1E4 0x1DF 0x1E4 0x1E3 0x1E5 0x1E1 0x1E1 0x1E0 0x1DB 0x1DF 0x1DF 0x1DE 0x1E1 0x1DC 0x1DB 0x1E4 0x1E9 0x1DD 0x1DF 0x1DF 0x1E6 0x1E1 0x1E4 0x1E2 0x1E1 0x1E0 0x1E6 0x1E6 0x1E4 0x1E2 0x1E3 0x1DB 0x1E3 0x1E4 0x1E2 0x1DE 0x1E1 0x1DD 0x1DE 0x1DE 0x1DD 0x1E0 0x1E0 0x1E2 0x1E4 0x1E4 0x1E1 0x1DF 0x1E5 0x1D7 0x1DA 0x1DB 0x1D9 0x1DD 0x1E1 0x1DE 0x1E3 0x1E2 0x1E0 0x1E4 0x1E0 0x1E5 0x1E2 0x1DE 0x1E3 0x1E0 0x1DD 0x1E1 0x1DF 0x1E0 0x1E2 0x1DB 0x1E1 0x1D9 0x1DA 0x1DD 0x1DE 0x1DA 0x1DD 0x1DD 0x1D8 0x1DA 0x1DA 0x1DD 0x1E1 0x1E0 0x1E1 0x1DE 0x1DC 0x1DB 0x1DC 0x1DD 0x1DB 0x1D8 0x1DB 0x1E1 0x1E1 0x1E3 0x1E3 0x1E0 0x1E3 0x1E1 0x1E5 0x1E2 0x1E1 0x1DE 0x1DF 0x1E0 0x1DD 0x1DE 0x1DA 0x1DD 0xF0 0xF0 0xF0>;
                    PS_Config_Lmt_FW_CC_P = <0x2A 0x2C 0x2C 0x2C 0x2A 0x2C 0x2C 0x2C 0x2C 0x2C 0x2C 0x2A 0x2C 0x2C 0x2C 0x2A 0x2C 0x2A 0x2A 0x2A 0x2A 0x2A 0x2A 0x2A 0x2A 0x2A 0x2A 0x2A 0x2A 0x2A 0x2A 0x2A 0x2A 0x2A 0x2A 0x2A 0x29 0x29 0x29 0x29 0x2A 0x2A 0x2A 0x2A 0x2A 0x2A 0x2A 0x2A 0x2C 0x2A 0x2C 0x2A 0x2A 0x2A 0x2A 0x2A 0x2A 0x2A 0x2A 0x2A 0x2A 0x2A 0x2A 0x2C 0x2A 0x2A 0x2A 0x2A 0x2A 0x2A 0x2A 0x2A 0x2A 0x2A 0x2A 0x2A 0x2A 0x2A 0x2A 0x2C 0x2C 0x2A 0x2A 0x2A 0x2A 0x2A 0x2A 0x2A 0x2A 0x2A 0x2A 0x2A 0x2A 0x2A 0x2A 0x2C 0x2C 0x2A 0x2A 0x2A 0x2A 0x2A 0x2A 0x2A 0x2A 0x2A 0x2A 0x2A 0x2A 0x2A 0x2A 0x2A 0x2C 0x2A 0x2A 0x2A 0x2A 0x2A 0x2A 0x2A 0x2A 0x2A 0x2A 0x2A 0x2A 0x2A 0x2A 0x2C 0x2A 0x2A 0x2A 0x2A 0x2A 0x2A 0x2A 0x2A 0x2A 0x2A 0x2A 0x2A 0x2A 0x2A 0x2A 0x2A 0x2C 0x2A 0x2A 0x2A 0x2A 0x2A 0x2A 0x2C 0x2A 0x2A 0x2A 0x2A 0x2A 0x2A 0x2A 0x2C 0x2C 0x2A 0x2A 0x2A 0x2A 0x2A 0x2A 0x2A 0x2A 0x2A 0x2A 0x2A 0x2A 0x2A 0x2A 0x2C 0x2C 0x2A 0x2A 0x2A 0x2A 0x2A 0x2A 0x2C 0x2A 0x2A 0x2A 0x2A 0x2A 0x2A 0x2A 0x2C 0x2A 0x2A 0x2A 0x2A 0x2A 0x2A 0x2A 0x2A 0x2A 0x2A 0x2A 0x2A 0x2A 0x2A 0x2A 0x2C 0x2C 0x2A 0x2A 0x2A 0x2A 0x2A 0x2A 0x2C 0x2A 0x2A 0x2A 0x2A 0x2A 0x2A 0x2A 0x2C 0x2C 0x2A 0x2A 0x2A 0x2A 0x2A 0x2A 0x2C 0x2A 0x2A 0x2A 0x2A 0x2A 0x2A 0x2A 0x2C 0x2C 0x2A 0x2C 0x2C 0x2C 0x2C 0x2C 0x2D 0x2A 0x2A 0x2A 0x2A 0x2A 0x2A 0x2A 0x2C 0x2C 0x2A 0x2A 0x2A 0x2A 0x2A 0x2A 0x2C 0x2A 0x2A 0x2A 0x2A 0x2A 0x2A 0x2A 0x2C 0x2C 0x2A 0x2A 0x2C 0x2C 0x2C 0x2C 0x2C 0x2A 0x2A 0x2A 0x2A 0x2A 0x2A 0x2A 0x2C 0x2C 0x2A 0x2A 0x29 0x29 0x2A 0x2A 0x29 0x2A 0x2A 0x2A 0x2A 0x2A 0x2A 0x2A 0x2C 0x2C 0x2A 0x2A 0x2A 0x2A 0x2A 0x2A 0x2A 0x2A 0x2A 0x2A 0x2A 0x2A 0x2A 0x2A 0x2C 0x2C 0x2A 0x2A 0x2A 0x2A 0x2A 0x2A 0x2A 0x2A 0x2A 0x2A 0x2A 0x2A 0x2A 0x2A 0x2C 0x2C 0x2A 0x2A 0x2A 0x2A 0x2A 0x2A 0x2A 0x2A 0x2A 0x2A 0x2A 0x2A 0x2A 0x2A 0x2C 0x2C 0x2A 0x2A 0x2A 0x2A 0x2A 0x2A 0x2A 0x2A 0x2A 0x2A 0x2A 0x2A 0x2A 0x2A 0x2C 0x2C 0x2A 0x2A 0x2A 0x2A 0x2A 0x2A 0x2A 0x2A 0x2A 0x2A 0x2A 0x2A 0x2A 0x2A 0x2C 0x2C 0x2A 0x2A 0x2A 0x2A 0x2A 0x2A 0x2A 0x2A 0x2A 0x2A 0x2A 0x2A 0x2A 0x2A 0x2C 0x2C 0x2A 0x2A 0x2A 0x2A 0x2A 0x2A 0x2A 0x2A 0x2A 0x2A 0x2A 0x2A 0x2A 0x2A 0x2C 0x2C 0x2A 0x2A 0x2A 0x2A 0x2A 0x2A 0x2A 0x2A 0x2A 0x2A 0x2A 0x2A 0x2A 0x2A 0x2C 0x2D 0x2C 0x2C 0x2C 0x2A 0x2A 0x2C 0x2C 0x2A 0x2A 0x2A 0x2A 0x2A 0x2A 0x2A 0x2C 0x2C 0x2A 0x2A 0x2A 0x2A 0x2A 0x2A 0x2A 0x2A 0x2A 0x2A 0x2A 0x2A 0x2A 0x2A 0x2C 0x2C 0x2A 0x2A 0x2A 0x2A 0x2A 0x2A 0x2A 0x2A 0x2A 0x2A 0x2A 0x2A 0x2A 0x2A 0x2C 0x2C 0x2A 0x2A 0x2A 0x2A 0x2A 0x2A 0x2A 0x2A 0x2A 0x2A 0x2A 0x2A 0x2A 0x2A 0x2C 0x2C 0x2A 0x2A 0x2A 0x2A 0x2A 0x2A 0x2A 0x2A 0x2A 0x2A 0x2A 0x2A 0x2A 0x2A 0x2C 0x2A 0x2A 0x2A 0x2A 0x2A 0x2A 0x2A 0x2A 0x2A 0x2A 0x2A 0x2A 0x2A 0x2A 0x2A 0x2C 0x2C 0x2A 0x2A 0x2A 0x2A 0x2A 0x2A 0x2A 0x2A 0x2A 0x2A 0x2A 0x2A 0x2A 0x2A 0x2C 0x2A 0x2A 0x2A 0x2A 0x2A 0x2A 0x2A 0x2A 0x2A 0x2A 0x2A 0x2A 0x2A 0x2A 0x2A 0x2A 0x2C 0x2C 0x2C 0x2A 0x2C 0x2C 0x2C 0x2C 0x2A 0x2A 0x2A 0x2A 0x2A 0x2A 0x2A 0x2A 0x13A 0x13A 0x13A>;
                    PS_Config_Lmt_FW_CC_N = <0x13 0x13 0x13 0x13 0x13 0x13 0x13 0x13 0x13 0x13 0x13 0x13 0x13 0x13 0x13 0x13 0x13 0x13 0x13 0x13 0x13 0x13 0x13 0x13 0x13 0x13 0x13 0x13 0x13 0x13 0x13 0x13 0x13 0x13 0x13 0x13 0x12 0x12 0x12 0x12 0x13 0x13 0x13 0x13 0x13 0x13 0x13 0x13 0x13 0x13 0x13 0x13 0x13 0x13 0x13 0x13 0x13 0x13 0x13 0x13 0x13 0x13 0x13 0x13 0x13 0x13 0x13 0x13 0x13 0x13 0x13 0x13 0x13 0x13 0x13 0x13 0x13 0x13 0x13 0x13 0x13 0x13 0x13 0x13 0x13 0x13 0x13 0x13 0x13 0x13 0x13 0x13 0x13 0x13 0x13 0x13 0x13 0x13 0x13 0x13 0x13 0x13 0x13 0x13 0x13 0x13 0x13 0x13 0x13 0x13 0x13 0x13 0x13 0x13 0x13 0x13 0x13 0x13 0x13 0x13 0x13 0x13 0x13 0x13 0x13 0x13 0x13 0x13 0x13 0x13 0x13 0x13 0x13 0x13 0x13 0x13 0x13 0x13 0x13 0x13 0x13 0x13 0x13 0x13 0x13 0x13 0x13 0x13 0x13 0x13 0x13 0x13 0x13 0x13 0x13 0x13 0x13 0x13 0x13 0x13 0x13 0x13 0x13 0x13 0x13 0x13 0x13 0x13 0x13 0x13 0x13 0x13 0x13 0x13 0x13 0x13 0x13 0x13 0x13 0x13 0x13 0x13 0x13 0x13 0x13 0x13 0x13 0x13 0x13 0x13 0x13 0x13 0x13 0x13 0x13 0x13 0x13 0x13 0x13 0x13 0x13 0x13 0x13 0x13 0x13 0x13 0x13 0x13 0x13 0x13 0x13 0x13 0x13 0x13 0x13 0x13 0x13 0x13 0x13 0x13 0x13 0x13 0x13 0x13 0x13 0x13 0x13 0x13 0x13 0x13 0x13 0x13 0x13 0x13 0x13 0x13 0x13 0x13 0x13 0x13 0x13 0x13 0x13 0x13 0x13 0x13 0x13 0x14 0x13 0x13 0x13 0x13 0x13 0x13 0x13 0x13 0x13 0x13 0x13 0x13 0x13 0x13 0x13 0x13 0x13 0x13 0x13 0x13 0x13 0x13 0x13 0x13 0x13 0x13 0x13 0x13 0x13 0x13 0x13 0x13 0x13 0x13 0x13 0x13 0x13 0x13 0x13 0x13 0x13 0x13 0x13 0x12 0x12 0x13 0x13 0x12 0x13 0x13 0x13 0x13 0x13 0x13 0x13 0x13 0x13 0x13 0x13 0x13 0x13 0x13 0x13 0x13 0x13 0x13 0x13 0x13 0x13 0x13 0x13 0x13 0x13 0x13 0x13 0x13 0x13 0x13 0x13 0x13 0x13 0x13 0x13 0x13 0x13 0x13 0x13 0x13 0x13 0x13 0x13 0x13 0x13 0x13 0x13 0x13 0x13 0x13 0x13 0x13 0x13 0x13 0x13 0x13 0x13 0x13 0x13 0x13 0x13 0x13 0x13 0x13 0x13 0x13 0x13 0x13 0x13 0x13 0x13 0x13 0x13 0x13 0x13 0x13 0x13 0x13 0x13 0x13 0x13 0x13 0x13 0x13 0x13 0x13 0x13 0x13 0x13 0x13 0x13 0x13 0x13 0x13 0x13 0x13 0x13 0x13 0x13 0x13 0x13 0x13 0x13 0x13 0x13 0x13 0x13 0x13 0x13 0x13 0x13 0x13 0x13 0x13 0x13 0x13 0x13 0x13 0x13 0x13 0x13 0x13 0x13 0x13 0x13 0x13 0x13 0x13 0x13 0x13 0x13 0x13 0x13 0x13 0x13 0x13 0x14 0x13 0x13 0x13 0x13 0x13 0x13 0x13 0x13 0x13 0x13 0x13 0x13 0x13 0x13 0x13 0x13 0x13 0x13 0x13 0x13 0x13 0x13 0x13 0x13 0x13 0x13 0x13 0x13 0x13 0x13 0x13 0x13 0x13 0x13 0x13 0x13 0x13 0x13 0x13 0x13 0x13 0x13 0x13 0x13 0x13 0x13 0x13 0x13 0x13 0x13 0x13 0x13 0x13 0x13 0x13 0x13 0x13 0x13 0x13 0x13 0x13 0x13 0x13 0x13 0x13 0x13 0x13 0x13 0x13 0x13 0x13 0x13 0x13 0x13 0x13 0x13 0x13 0x13 0x13 0x13 0x13 0x13 0x13 0x13 0x13 0x13 0x13 0x13 0x13 0x13 0x13 0x13 0x13 0x13 0x13 0x13 0x13 0x13 0x13 0x13 0x13 0x13 0x13 0x13 0x13 0x13 0x13 0x13 0x13 0x13 0x13 0x13 0x13 0x13 0x13 0x13 0x13 0x13 0x13 0x13 0x13 0x13 0x13 0x13 0x13 0x13 0x13 0x13 0x13 0x13 0x13 0x13 0x13 0x13 0x13 0x13 0x13 0x13 0x13 0x13 0x13 0x13 0x13 0x0 0x0 0x0>;
                    PS_Config_Lmt_FW_Diff_P = <0x32 0x32 0x32 0x32 0x32 0x32 0x32 0x32 0x32 0x32 0x32 0x32 0x32 0x32 0x32 0x32 0x32 0x32 0x32 0x32 0x32 0x32 0x32 0x32 0x32 0x32 0x32 0x32 0x32 0x32 0x32 0x32 0x32 0x32 0x32 0x32 0x32 0x32 0x32 0x32 0x32 0x32 0x32 0x32 0x32 0x32 0x32 0x32 0x32 0x32 0x32 0x32 0x32 0x32 0x32 0x32 0x32 0x32 0x32 0x32 0x32 0x32 0x32 0x32 0x32 0x32 0x32 0x32 0x32 0x32 0x32 0x32 0x32 0x32 0x32 0x32 0x32 0x32 0x32 0x32 0x32 0x32 0x32 0x32 0x32 0x32 0x32 0x32 0x32 0x32 0x32 0x32 0x32 0x32 0x32 0x32 0x32 0x32 0x32 0x32 0x32 0x32 0x32 0x32 0x32 0x32 0x32 0x32 0x32 0x32 0x32 0x32 0x32 0x32 0x32 0x32 0x32 0x32 0x32 0x32 0x32 0x32 0x32 0x32 0x32 0x32 0x32 0x32 0x32 0x32 0x32 0x32 0x32 0x32 0x32 0x32 0x32 0x32 0x32 0x32 0x32 0x32 0x32 0x32 0x32 0x32 0x32 0x32 0x32 0x32 0x32 0x32 0x32 0x32 0x32 0x32 0x32 0x32 0x32 0x32 0x32 0x32 0x32 0x32 0x32 0x32 0x32 0x32 0x32 0x32 0x32 0x32 0x32 0x32 0x32 0x32 0x32 0x32 0x32 0x32 0x32 0x32 0x32 0x32 0x32 0x32 0x32 0x32 0x32 0x32 0x32 0x32 0x32 0x32 0x32 0x32 0x32 0x32 0x32 0x32 0x32 0x32 0x32 0x32 0x32 0x32 0x32 0x32 0x32 0x32 0x32 0x32 0x32 0x32 0x32 0x32 0x32 0x32 0x32 0x32 0x32 0x32 0x32 0x32 0x32 0x32 0x32 0x32 0x32 0x32 0x32 0x32 0x32 0x32 0x32 0x32 0x32 0x32 0x32 0x32 0x32 0x32 0x32 0x32 0x32 0x32 0x32 0x32 0x32 0x32 0x32 0x32 0x32 0x32 0x32 0x32 0x32 0x32 0x32 0x32 0x32 0x32 0x32 0x32 0x32 0x32 0x32 0x32 0x32 0x32 0x32 0x32 0x32 0x32 0x32 0x32 0x32 0x32 0x32 0x32 0x32 0x32 0x32 0x32 0x32 0x32 0x32 0x32 0x32 0x32 0x32 0x32 0x32 0x32 0x32 0x32 0x32 0x32 0x32 0x32 0x32 0x32 0x32 0x32 0x32 0x32 0x32 0x32 0x32 0x32 0x32 0x32 0x32 0x32 0x32 0x32 0x32 0x32 0x32 0x32 0x32 0x32 0x32 0x32 0x32 0x32 0x32 0x32 0x32 0x32 0x32 0x32 0x32 0x32 0x32 0x32 0x32 0x32 0x32 0x32 0x32 0x32 0x32 0x32 0x32 0x32 0x32 0x32 0x32 0x32 0x32 0x32 0x32 0x32 0x32 0x32 0x32 0x32 0x32 0x32 0x32 0x32 0x32 0x32 0x32 0x32 0x32 0x32 0x32 0x32 0x32 0x32 0x32 0x32 0x32 0x32 0x32 0x32 0x32 0x32 0x32 0x32 0x32 0x32 0x32 0x32 0x32 0x32 0x32 0x32 0x32 0x32 0x32 0x32 0x32 0x32 0x32 0x32 0x32 0x32 0x32 0x32 0x32 0x32 0x32 0x32 0x32 0x32 0x32 0x32 0x32 0x32 0x32 0x32 0x32 0x32 0x32 0x32 0x32 0x32 0x32 0x32 0x32 0x32 0x32 0x32 0x32 0x32 0x32 0x32 0x32 0x32 0x32 0x32 0x32 0x32 0x32 0x32 0x32 0x32 0x32 0x32 0x32 0x32 0x32 0x32 0x32 0x32 0x32 0x32 0x32 0x32 0x32 0x32 0x32 0x32 0x32 0x32 0x32 0x32 0x32 0x32 0x32 0x32 0x32 0x32 0x32 0x32 0x32 0x32 0x32 0x32 0x32 0x32 0x32 0x32 0x32 0x32 0x32 0x32 0x32 0x32 0x32 0x32 0x32 0x32 0x32 0x32 0x32 0x32 0x32 0x32 0x32 0x32 0x32 0x32 0x32 0x32 0x32 0x32 0x32 0x32 0x32 0x32 0x32 0x32 0x32 0x32 0x32 0x32 0x32 0x32 0x32 0x32 0x32 0x32 0x32 0x32 0x32 0x32 0x32 0x32 0x32 0x32 0x32 0x32 0x32 0x32 0x32 0x32 0x32 0x32 0x32 0x32 0x32 0x32 0x32 0x32 0x32 0x32 0x32 0x32 0x32 0x32 0x32 0x32 0x32 0x32 0x32 0x32 0x32 0x32 0x32 0x32 0x32 0x32 0x32 0x32 0x32 0x32 0x32 0x32 0x32 0x32 0x32 0x32 0x32 0x32 0x32 0x32 0x32 0x32 0x32 0x32 0x32 0x32 0x4B 0x4B 0x4B>;
                    PS_Config_Lmt_FW_Diff_N = <0xFFFFFFCE 0xFFFFFFCE 0xFFFFFFCE 0xFFFFFFCE 0xFFFFFFCE 0xFFFFFFCE 0xFFFFFFCE 0xFFFFFFCE 0xFFFFFFCE 0xFFFFFFCE 0xFFFFFFCE 0xFFFFFFCE 0xFFFFFFCE 0xFFFFFFCE 0xFFFFFFCE 0xFFFFFFCE 0xFFFFFFCE 0xFFFFFFCE 0xFFFFFFCE 0xFFFFFFCE 0xFFFFFFCE 0xFFFFFFCE 0xFFFFFFCE 0xFFFFFFCE 0xFFFFFFCE 0xFFFFFFCE 0xFFFFFFCE 0xFFFFFFCE 0xFFFFFFCE 0xFFFFFFCE 0xFFFFFFCE 0xFFFFFFCE 0xFFFFFFCE 0xFFFFFFCE 0xFFFFFFCE 0xFFFFFFCE 0xFFFFFFCE 0xFFFFFFCE 0xFFFFFFCE 0xFFFFFFCE 0xFFFFFFCE 0xFFFFFFCE 0xFFFFFFCE 0xFFFFFFCE 0xFFFFFFCE 0xFFFFFFCE 0xFFFFFFCE 0xFFFFFFCE 0xFFFFFFCE 0xFFFFFFCE 0xFFFFFFCE 0xFFFFFFCE 0xFFFFFFCE 0xFFFFFFCE 0xFFFFFFCE 0xFFFFFFCE 0xFFFFFFCE 0xFFFFFFCE 0xFFFFFFCE 0xFFFFFFCE 0xFFFFFFCE 0xFFFFFFCE 0xFFFFFFCE 0xFFFFFFCE 0xFFFFFFCE 0xFFFFFFCE 0xFFFFFFCE 0xFFFFFFCE 0xFFFFFFCE 0xFFFFFFCE 0xFFFFFFCE 0xFFFFFFCE 0xFFFFFFCE 0xFFFFFFCE 0xFFFFFFCE 0xFFFFFFCE 0xFFFFFFCE 0xFFFFFFCE 0xFFFFFFCE 0xFFFFFFCE 0xFFFFFFCE 0xFFFFFFCE 0xFFFFFFCE 0xFFFFFFCE 0xFFFFFFCE 0xFFFFFFCE 0xFFFFFFCE 0xFFFFFFCE 0xFFFFFFCE 0xFFFFFFCE 0xFFFFFFCE 0xFFFFFFCE 0xFFFFFFCE 0xFFFFFFCE 0xFFFFFFCE 0xFFFFFFCE 0xFFFFFFCE 0xFFFFFFCE 0xFFFFFFCE 0xFFFFFFCE 0xFFFFFFCE 0xFFFFFFCE 0xFFFFFFCE 0xFFFFFFCE 0xFFFFFFCE 0xFFFFFFCE 0xFFFFFFCE 0xFFFFFFCE 0xFFFFFFCE 0xFFFFFFCE 0xFFFFFFCE 0xFFFFFFCE 0xFFFFFFCE 0xFFFFFFCE 0xFFFFFFCE 0xFFFFFFCE 0xFFFFFFCE 0xFFFFFFCE 0xFFFFFFCE 0xFFFFFFCE 0xFFFFFFCE 0xFFFFFFCE 0xFFFFFFCE 0xFFFFFFCE 0xFFFFFFCE 0xFFFFFFCE 0xFFFFFFCE 0xFFFFFFCE 0xFFFFFFCE 0xFFFFFFCE 0xFFFFFFCE 0xFFFFFFCE 0xFFFFFFCE 0xFFFFFFCE 0xFFFFFFCE 0xFFFFFFCE 0xFFFFFFCE 0xFFFFFFCE 0xFFFFFFCE 0xFFFFFFCE 0xFFFFFFCE 0xFFFFFFCE 0xFFFFFFCE 0xFFFFFFCE 0xFFFFFFCE 0xFFFFFFCE 0xFFFFFFCE 0xFFFFFFCE 0xFFFFFFCE 0xFFFFFFCE 0xFFFFFFCE 0xFFFFFFCE 0xFFFFFFCE 0xFFFFFFCE 0xFFFFFFCE 0xFFFFFFCE 0xFFFFFFCE 0xFFFFFFCE 0xFFFFFFCE 0xFFFFFFCE 0xFFFFFFCE 0xFFFFFFCE 0xFFFFFFCE 0xFFFFFFCE 0xFFFFFFCE 0xFFFFFFCE 0xFFFFFFCE 0xFFFFFFCE 0xFFFFFFCE 0xFFFFFFCE 0xFFFFFFCE 0xFFFFFFCE 0xFFFFFFCE 0xFFFFFFCE 0xFFFFFFCE 0xFFFFFFCE 0xFFFFFFCE 0xFFFFFFCE 0xFFFFFFCE 0xFFFFFFCE 0xFFFFFFCE 0xFFFFFFCE 0xFFFFFFCE 0xFFFFFFCE 0xFFFFFFCE 0xFFFFFFCE 0xFFFFFFCE 0xFFFFFFCE 0xFFFFFFCE 0xFFFFFFCE 0xFFFFFFCE 0xFFFFFFCE 0xFFFFFFCE 0xFFFFFFCE 0xFFFFFFCE 0xFFFFFFCE 0xFFFFFFCE 0xFFFFFFCE 0xFFFFFFCE 0xFFFFFFCE 0xFFFFFFCE 0xFFFFFFCE 0xFFFFFFCE 0xFFFFFFCE 0xFFFFFFCE 0xFFFFFFCE 0xFFFFFFCE 0xFFFFFFCE 0xFFFFFFCE 0xFFFFFFCE 0xFFFFFFCE 0xFFFFFFCE 0xFFFFFFCE 0xFFFFFFCE 0xFFFFFFCE 0xFFFFFFCE 0xFFFFFFCE 0xFFFFFFCE 0xFFFFFFCE 0xFFFFFFCE 0xFFFFFFCE 0xFFFFFFCE 0xFFFFFFCE 0xFFFFFFCE 0xFFFFFFCE 0xFFFFFFCE 0xFFFFFFCE 0xFFFFFFCE 0xFFFFFFCE 0xFFFFFFCE 0xFFFFFFCE 0xFFFFFFCE 0xFFFFFFCE 0xFFFFFFCE 0xFFFFFFCE 0xFFFFFFCE 0xFFFFFFCE 0xFFFFFFCE 0xFFFFFFCE 0xFFFFFFCE 0xFFFFFFCE 0xFFFFFFCE 0xFFFFFFCE 0xFFFFFFCE 0xFFFFFFCE 0xFFFFFFCE 0xFFFFFFCE 0xFFFFFFCE 0xFFFFFFCE 0xFFFFFFCE 0xFFFFFFCE 0xFFFFFFCE 0xFFFFFFCE 0xFFFFFFCE 0xFFFFFFCE 0xFFFFFFCE 0xFFFFFFCE 0xFFFFFFCE 0xFFFFFFCE 0xFFFFFFCE 0xFFFFFFCE 0xFFFFFFCE 0xFFFFFFCE 0xFFFFFFCE 0xFFFFFFCE 0xFFFFFFCE 0xFFFFFFCE 0xFFFFFFCE 0xFFFFFFCE 0xFFFFFFCE 0xFFFFFFCE 0xFFFFFFCE 0xFFFFFFCE 0xFFFFFFCE 0xFFFFFFCE 0xFFFFFFCE 0xFFFFFFCE 0xFFFFFFCE 0xFFFFFFCE 0xFFFFFFCE 0xFFFFFFCE 0xFFFFFFCE 0xFFFFFFCE 0xFFFFFFCE 0xFFFFFFCE 0xFFFFFFCE 0xFFFFFFCE 0xFFFFFFCE 0xFFFFFFCE 0xFFFFFFCE 0xFFFFFFCE 0xFFFFFFCE 0xFFFFFFCE 0xFFFFFFCE 0xFFFFFFCE 0xFFFFFFCE 0xFFFFFFCE 0xFFFFFFCE 0xFFFFFFCE 0xFFFFFFCE 0xFFFFFFCE 0xFFFFFFCE 0xFFFFFFCE 0xFFFFFFCE 0xFFFFFFCE 0xFFFFFFCE 0xFFFFFFCE 0xFFFFFFCE 0xFFFFFFCE 0xFFFFFFCE 0xFFFFFFCE 0xFFFFFFCE 0xFFFFFFCE 0xFFFFFFCE 0xFFFFFFCE 0xFFFFFFCE 0xFFFFFFCE 0xFFFFFFCE 0xFFFFFFCE 0xFFFFFFCE 0xFFFFFFCE 0xFFFFFFCE 0xFFFFFFCE 0xFFFFFFCE 0xFFFFFFCE 0xFFFFFFCE 0xFFFFFFCE 0xFFFFFFCE 0xFFFFFFCE 0xFFFFFFCE 0xFFFFFFCE 0xFFFFFFCE 0xFFFFFFCE 0xFFFFFFCE 0xFFFFFFCE 0xFFFFFFCE 0xFFFFFFCE 0xFFFFFFCE 0xFFFFFFCE 0xFFFFFFCE 0xFFFFFFCE 0xFFFFFFCE 0xFFFFFFCE 0xFFFFFFCE 0xFFFFFFCE 0xFFFFFFCE 0xFFFFFFCE 0xFFFFFFCE 0xFFFFFFCE 0xFFFFFFCE 0xFFFFFFCE 0xFFFFFFCE 0xFFFFFFCE 0xFFFFFFCE 0xFFFFFFCE 0xFFFFFFCE 0xFFFFFFCE 0xFFFFFFCE 0xFFFFFFCE 0xFFFFFFCE 0xFFFFFFCE 0xFFFFFFCE 0xFFFFFFCE 0xFFFFFFCE 0xFFFFFFCE 0xFFFFFFCE 0xFFFFFFCE 0xFFFFFFCE 0xFFFFFFCE 0xFFFFFFCE 0xFFFFFFCE 0xFFFFFFCE 0xFFFFFFCE 0xFFFFFFCE 0xFFFFFFCE 0xFFFFFFCE 0xFFFFFFCE 0xFFFFFFCE 0xFFFFFFCE 0xFFFFFFCE 0xFFFFFFCE 0xFFFFFFCE 0xFFFFFFCE 0xFFFFFFCE 0xFFFFFFCE 0xFFFFFFCE 0xFFFFFFCE 0xFFFFFFCE 0xFFFFFFCE 0xFFFFFFCE 0xFFFFFFCE 0xFFFFFFCE 0xFFFFFFCE 0xFFFFFFCE 0xFFFFFFCE 0xFFFFFFCE 0xFFFFFFCE 0xFFFFFFCE 0xFFFFFFCE 0xFFFFFFCE 0xFFFFFFCE 0xFFFFFFCE 0xFFFFFFCE 0xFFFFFFCE 0xFFFFFFCE 0xFFFFFFCE 0xFFFFFFCE 0xFFFFFFCE 0xFFFFFFCE 0xFFFFFFCE 0xFFFFFFCE 0xFFFFFFCE 0xFFFFFFCE 0xFFFFFFCE 0xFFFFFFCE 0xFFFFFFCE 0xFFFFFFCE 0xFFFFFFCE 0xFFFFFFCE 0xFFFFFFCE 0xFFFFFFCE 0xFFFFFFCE 0xFFFFFFCE 0xFFFFFFCE 0xFFFFFFCE 0xFFFFFFCE 0xFFFFFFCE 0xFFFFFFCE 0xFFFFFFCE 0xFFFFFFCE 0xFFFFFFCE 0xFFFFFFCE 0xFFFFFFCE 0xFFFFFFCE 0xFFFFFFCE 0xFFFFFFCE 0xFFFFFFCE 0xFFFFFFCE 0xFFFFFFCE 0xFFFFFFCE 0xFFFFFFCE 0xFFFFFFCE 0xFFFFFFCE 0xFFFFFFCE 0xFFFFFFCE 0xFFFFFFCE 0xFFFFFFCE 0xFFFFFFCE 0xFFFFFFCE 0xFFFFFFCE 0xFFFFFFCE 0xFFFFFFCE 0xFFFFFFCE 0xFFFFFFCE 0xFFFFFFCE 0xFFFFFFCE 0xFFFFFFCE 0xFFFFFFCE 0xFFFFFFCE 0xFFFFFFCE 0xFFFFFFCE 0xFFFFFFCE 0xFFFFFFCE 0xFFFFFFCE 0xFFFFFFCE 0xFFFFFFCE 0xFFFFFFCE 0xFFFFFFCE 0xFFFFFFCE 0xFFFFFFCE 0xFFFFFFCE 0xFFFFFFCE 0xFFFFFFCE 0xFFFFFFCE 0xFFFFFFCE 0xFFFFFFCE 0xFFFFFFCE 0xFFFFFFCE 0xFFFFFFCE 0xFFFFFFCE 0xFFFFFFCE 0xFFFFFFCE 0xFFFFFFCE 0xFFFFFFCE 0xFFFFFFCE 0xFFFFFFCE 0xFFFFFFCE 0xFFFFFFCE 0xFFFFFFCE 0xFFFFFFCE 0xFFFFFFCE 0xFFFFFFCE 0xFFFFFFCE 0xFFFFFFCE 0xFFFFFFCE 0xFFFFFFCE 0xFFFFFFCE 0xFFFFFFCE 0xFFFFFFCE 0xFFFFFFCE 0xFFFFFFCE 0xFFFFFFCE 0xFFFFFFCE 0xFFFFFFCE 0xFFFFFFCE 0xFFFFFFCE 0xFFFFFFCE 0xFFFFFFCE 0xFFFFFFCE 0xFFFFFFCE 0xFFFFFFCE 0xFFFFFFCE 0xFFFFFFCE 0xFFFFFFCE 0xFFFFFFCE 0xFFFFFFCE 0xFFFFFFCE 0xFFFFFFCE 0xFFFFFFCE 0xFFFFFFCE 0xFFFFFFCE 0xFFFFFFCE 0xFFFFFFCE 0xFFFFFFCE 0xFFFFFFCE 0xFFFFFFCE 0xFFFFFFCE 0xFFFFFFCE 0xFFFFFFCE 0xFFFFFFCE 0xFFFFFFCE 0xFFFFFFCE 0xFFFFFFCE 0xFFFFFFCE 0xFFFFFFCE 0xFFFFFFCE 0xFFFFFFCE 0xFFFFFFCE 0xFFFFFFCE 0xFFFFFFCE 0xFFFFFFCE 0xFFFFFFCE 0xFFFFFFCE 0xFFFFFFCE 0xFFFFFFCE 0xFFFFFFCE 0xFFFFFFCE 0xFFFFFFCE 0xFFFFFFCE 0xFFFFFFCE 0xFFFFFFCE 0xFFFFFFCE 0xFFFFFFCE 0xFFFFFFCE 0xFFFFFFCE 0xFFFFFFCE 0xFFFFFFCE 0xFFFFFFCE 0xFFFFFFCE 0xFFFFFFCE 0xFFFFFFCE 0xFFFFFFCE 0xFFFFFFCE 0xFFFFFFCE 0xFFFFFFCE 0xFFFFFFCE 0xFFFFFFCE 0xFFFFFFCE 0xFFFFFFCE 0xFFFFFFCE 0xFFFFFFCE 0xFFFFFFCE 0xFFFFFFCE 0xFFFFFFCE 0xFFFFFFCE 0xFFFFFFCE 0xFFFFFFB5 0xFFFFFFB5 0xFFFFFFB5>;
                    PS_Config_Diff_Test_Frame = <0x32>;
                };
            };
        };
    };
    fragment@26 {
        target = <0xFFFFFFFF>;
        __overlay__ {
            mediatek,speaker-codec {
                sound-dai = <0x2A>;
            };
        };
    };
    fragment@27 {
        target = <0xFFFFFFFF>;
        __overlay__ {
            fs16xx@34 {
                compatible = "foursemi,fs16xx";
                #sound-dai-cells = <0x0>;
                reg = <0x34>;
                fsm,re25-dft = <0x1E00>;
                status = "okay";
                phandle = <0x2A>;
            };
        };
    };
    fragment@28 {
        target = <0xFFFFFFFF>;
        __overlay__ {
            speaker_amp@5c {
                status = "disable";
                phandle = <0x5C>;
            };
        };
    };
    fragment@29 {
        target = <0xFFFFFFFF>;
        __overlay__ {
            otg_init {
                phandle = <0x2B>;
                pins_cmd_dat {
                    pinmux = <0xB400>;
                    slew-rate = <0x1>;
                };
            };
            otg_low {
                phandle = <0x2C>;
                pins_cmd_dat {
                    pinmux = <0xB400>;
                    slew-rate = <0x1>;
                    output-low;
                };
            };
            otg_high {
                phandle = <0x2D>;
                pins_cmd_dat {
                    pinmux = <0xB400>;
                    slew-rate = <0x1>;
                    output-high;
                };
            };
            meta_init {
                phandle = <0x2E>;
                pins_cmd_dat {
                    pinmux = <0xB500>;
                    slew-rate = <0x1>;
                };
            };
            meta_low {
                phandle = <0x2F>;
                pins_cmd_dat {
                    pinmux = <0xB500>;
                    slew-rate = <0x1>;
                    output-low;
                };
            };
            meta_high {
                phandle = <0x30>;
                pins_cmd_dat {
                    pinmux = <0xB500>;
                    slew-rate = <0x1>;
                    output-high;
                };
            };
        };
    };
    fragment@30 {
        target = <0xFFFFFFFF>;
        __overlay__ {
            mediatek,eye-vrt = <0x6>;
            mediatek,eye-term = <0x6>;
            mediatek,eye-rev6 = <0x1>;
            mediatek,host-eye-vrt = <0x6>;
            mediatek,host-eye-term = <0x6>;
            mediatek,host-eye-rev6 = <0x2>;
        };
    };
    fragment@31 {
        target = <0xFFFFFFFF>;
        __overlay__ {
            tran_battery {
                compatible = "tran,chg_fun";
                pinctrl-names = "otg_gpio_init", "otg_gpio_low", "otg_gpio_high", "meta_gpio_init", "meta_gpio_low", "meta_gpio_high";
                pinctrl-0 = <0x2B>;
                pinctrl-1 = <0x2C>;
                pinctrl-2 = <0x2D>;
                pinctrl-3 = <0x2E>;
                pinctrl-4 = <0x2F>;
                pinctrl-5 = <0x30>;
                enable_pcb_tml;
                pcb_temp_step_one = <0xA410>;
                pcb_cur_step_one = <0x1F4>;
                pcb_temp_step_two = <0xABE0>;
                pcb_cur_step_two = <0x1F4>;
                pcb_min_chg_cur = <0xF4240>;
                jeita_below_t0_chg_cur = <0x0>;
                jeita_t0_to_t1_chg_cur = <0xF4240>;
                jeita_t2_to_t3_chg_cur = <0x1E8480>;
                jeita_t3_to_t4_chg_cur = <0x1E8480>;
                jeita_above_t4_chg_cur = <0x0>;
                jeita_below_t0_input_cur = <0x16E360>;
                jeita_t0_to_t1_input_cur = <0x16E360>;
                jeita_t2_to_t3_input_cur = <0x200B20>;
                jeita_t3_to_t4_input_cur = <0x200B20>;
                jeita_above_t4_input_cur = <0xF4240>;
                phandle = <0x5D>;
            };
            tran_battery_aging {
                compatible = "tran,chg_aging";
                battery_aging_module0 = <0x0>;
                battery_aging_module1 = <0x0>;
                battery_aging_module2 = <0x0>;
                battery_aging_module3 = <0x0>;
                phandle = <0x5E>;
            };
            pca_pps_ta {
                compatible = "richtek,pca_pps_ta";
                status = "okay";
            };
            pd_adapter {
                compatible = "mediatek,pd_adapter";
                adapter_name = "pd_adapter";
                phandle = <0x5F>;
            };
            usb_switch {
                compatible = "tran,usb_switch";
                switch_built_in_ic;
                status = "okay";
                phandle = <0x60>;
            };
            pca_rfc_ta {
                compatible = "richtek,pca_rfc_ta";
                status = "okay";
                adapter_name = "rfc_adapter";
                vta_step = <0x14>;
                ita_step = <0x1E>;
                ita_gap_per_vstep = <0x14>;
                ita_gap_cv_mode = <0xC8>;
                pwr_lmt;
                support_meas_cap;
                support_status;
            };
        };
    };
    fragment@32 {
        target = <0xFFFFFFFF>;
        __overlay__ {
            clock-frequency = <0x186A0>;
            rfc_ta@1b {
                compatible = "richtek,rfc_ta";
                reg = <0x1B>;
                status = "okay";
            };
        };
    };
    fragment@33 {
        target = <0xFFFFFFFF>;
        __overlay__ {
            compatible = "mediatek,charger";
            algorithm_name = "SwitchCharging";
            enable_sw_jeita;
            enable_pe_plus;
            enable_pe_2;
            enable_hvdcp20;
            enable_tc30;
            enable_pe_5;
            enable_type_c;
            power_path_support;
            enable_ir_comp;
            r_bat_comp = <0x1E>;
            v_comp_max = <0x9C40>;
            disable_pd_dual;
            multi_battery_cv;
            battery_cv = <0x43E6D0 0x43E6D0 0x43E6D0 0x43E6D0>;
            max_charger_voltage = <0x632EA0>;
            min_charger_voltage = <0x4630C0>;
            min_charger_voltage_1 = <0x432380>;
            min_charger_voltage_2 = <0x401640>;
            max_dmivr_charger_current = <0x155CC0>;
            usb_charger_current_suspend = <0x0>;
            usb_charger_current_unconfigured = <0x11170>;
            usb_charger_current_configured = <0x7A120>;
            usb_charger_current = <0x7A120>;
            ac_charger_current = <0x2191C0>;
            ac_charger_input_current = <0x1E8480>;
            non_std_ac_charger_current = <0x124F80>;
            charging_host_charger_current = <0x16E360>;
            apple_1_0a_charger_current = <0x9EB10>;
            apple_2_1a_charger_current = <0xC3500>;
            ta_ac_charger_current = <0x2DC6C0>;
            jeita_temp_above_t4_cv = <0x3F52F0 0x3F52F0 0x3F52F0 0x3F52F0>;
            jeita_temp_t3_to_t4_cv = <0x3F52F0 0x3F52F0 0x3F52F0 0x3F52F0>;
            jeita_temp_t2_to_t3_cv = <0x43E6D0 0x43E6D0 0x43E6D0 0x43E6D0>;
            jeita_temp_t1_to_t2_cv = <0x43E6D0 0x43E6D0 0x43E6D0 0x43E6D0>;
            jeita_temp_t0_to_t1_cv = <0x43E6D0 0x43E6D0 0x43E6D0 0x43E6D0>;
            jeita_temp_below_t0_cv = <0x43E6D0 0x43E6D0 0x43E6D0 0x43E6D0>;
            temp_t4_thres = <0x37>;
            temp_t4_thres_minus_x_degree = <0x33>;
            temp_t3_thres = <0x2D>;
            temp_t3_thres_minus_x_degree = <0x2C>;
            temp_t2_thres = <0xF>;
            temp_t2_thres_plus_x_degree = <0x10>;
            temp_t1_thres = <0x1>;
            temp_t1_thres_plus_x_degree = <0x1>;
            temp_t0_thres = <0x1>;
            temp_t0_thres_plus_x_degree = <0x1>;
            temp_neg_10_thres = <0x2>;
            enable_min_charge_temp;
            min_charge_temp = <0x0>;
            min_charge_temp_plus_x_degree = <0x1>;
            max_charge_temp = <0x35>;
            max_charge_temp_minus_x_degree = <0x34>;
            ta_9v_support;
            pe_ichg_level_threshold = <0xF4240>;
            ta_ac_12v_input_current = <0x30D400>;
            ta_ac_9v_input_current = <0x200B20>;
            ta_ac_7v_input_current = <0x249F00>;
            pe20_ichg_level_threshold = <0xF4240>;
            ta_start_battery_soc = <0x0>;
            ta_stop_battery_soc = <0x5A>;
            high_temp_to_leave_pe40 = <0x2E>;
            high_temp_to_enter_pe40 = <0x27>;
            low_temp_to_leave_pe40 = <0xA>;
            low_temp_to_enter_pe40 = <0x10>;
            pe40_single_charger_input_current = <0x2DC6C0>;
            pe40_single_charger_current = <0x2DC6C0>;
            pe40_dual_charger_input_current = <0x2DC6C0>;
            pe40_dual_charger_chg1_current = <0x1E8480>;
            pe40_dual_charger_chg2_current = <0x1E8480>;
            pe40_stop_battery_soc = <0x50>;
            pe40_r_cable_1a_lower = <0x206>;
            pe40_r_cable_2a_lower = <0x17F>;
            pe40_r_cable_3a_lower = <0xF5>;
            chg1_ta_ac_charger_current = <0x16E360>;
            chg2_ta_ac_charger_current = <0x16E360>;
            slave_mivr_diff = <0x186A0>;
            dual_polling_ieoc = <0x6DDD0>;
            cable_imp_threshold = <0x2BB>;
            vbat_cable_imp_threshold = <0x3B8260>;
            bif_threshold1 = <0x40D990>;
            bif_threshold2 = <0x419CE0>;
            bif_cv_under_threshold2 = <0x43E6D0>;
            pd_vbus_low_bound = <0x4C4B40>;
            pd_vbus_upper_bound = <0x895440>;
            pd_ichg_level_threshold = <0xF4240>;
            pd_stop_battery_soc = <0x55>;
            ibus_err = <0xE>;
            vsys_watt = <0x4C4B40>;
            max_charging_time = <0x11940>;
            dv2_chg_cv = <0x445C00 0x445C00 0x445C00 0x445C00>;
            dv2_chg_eoc = <0x9EB10>;
            comp_ir = <0xC350>;
            comp_iv = <0x1F400>;
        };
    };
    fragment@34 {
        target = <0xFFFFFFFF>;
        __overlay__ {
            compatible = "mediatek,lk_charger";
            enable_anime;
            enable_pe_plus;
            enable_pd20_reset;
            power_path_support;
            max_charger_voltage = <0x632EA0>;
            fast_charge_voltage = <0x2625A0>;
            usb_charger_current = <0x7A120>;
            ac_charger_current = <0x16E360>;
            ac_charger_input_current = <0x16E360>;
            non_std_ac_charger_current = <0x7A120>;
            charging_host_charger_current = <0x16E360>;
            ta_ac_charger_current = <0x2DC6C0>;
            pd_charger_current = <0x7A120>;
            cur_threshold = <0x7A120>;
            temp_t4_threshold = <0x32>;
            temp_t3_threshold = <0x2D>;
            temp_t2_threshold = <0xF>;
            temp_t1_threshold = <0x0>;
        };
    };
    fragment@35 {
        target = <0xFFFFFFFF>;
        __overlay__ {
            #address-cells = <0x1>;
            #size-cells = <0x0>;
            hl7138_master@55 {
                compatible = "richtek,hl7139";
                status = "okay";
                reg = <0x55>;
                rm_name = "hl7139";
                rm_slave_addr = [55];
                hl7138,intr-gpios = <0xFFFFFFFF 0x6 0x0>;
                standalone {
                    chg_name = "primary_divider_chg";
                    vbatovp = <0x456D70>;
                    ibatocp = <0x6C5660>;
                    vbusovp = <0xA7D8C0>;
                    ibusocp = <0x40D990>;
                    vacovp = <0xA7D8C0>;
                    wdt = <0x1C9C380>;
                    ibat_rsense = <0x1>;
                    gpp_conf = <0x0>;
                    protocol_i_masked;
                    vbat_reg_dis;
                    ibat_reg_dis;
                    iin_reg_dis;
                    track_ov_dis;
                    track_uv_dis;
                    vbatovp_dis;
                    ibatocp_dis;
                    ibusocp_dis;
                };
                master {
                    chg_name = "primary_divider_chg";
                    vbatovp = <0x44AA20>;
                    ibatocp = <0x5D1420>;
                    vbusovp = <0xA7D8C0>;
                    ibusocp = <0x40D990>;
                    vacovp = <0xA7D8C0>;
                    wdt = <0x1C9C380>;
                    ibat_rsense = <0x1>;
                    state_chg_i_masked = <0x0>;
                    reg_i_masked = <0x0>;
                    ts_temp_i_masked = <0x0>;
                    v_ok_i_masked = <0x0>;
                    cur_i_masked = <0x0>;
                    short_i_masked = <0x0>;
                    wdog_i_masked = <0x0>;
                    protocol_i_masked = <0x0>;
                    vbat_reg_dis;
                    ibat_reg_dis;
                    iin_reg_dis;
                    track_ov_dis;
                    track_uv_dis;
                    ibatocp_dis;
                    tsbusotp_dis;
                    tsbatotp_dis;
                    tsbusadc_dis;
                    tsbatadc_dis;
                };
            };
        };
    };
    fragment@36 {
        target = <0xFFFFFFFF>;
        __overlay__ {
            mtk_pe50 {
                polling_interval = <0x2710>;
                ta_cv_ss_repeat_tmin = <0x19>;
                vbat_cv = <0x1180>;
                start_soc_min = <0x0>;
                start_soc_max = <0x5A>;
                start_vbat_max = <0x1144>;
                idvchg_term = <0x203>;
                idvchg_step = <0x32>;
                ita_level = <0xBB8 0x8CA 0x7D0 0x5DC>;
                rcable_level = <0x12C 0x15E 0x1C2 0x258>;
                ita_level_dual = <0xFA0 0xE74 0xD48 0xBB8>;
                rcable_level_dual = <0xBC 0xCB 0xDD 0xFA>;
                idvchg_ss_init = <0x4B0>;
                idvchg_ss_step = <0xFA>;
                idvchg_ss_step1 = <0x64>;
                idvchg_ss_step2 = <0x32>;
                idvchg_ss_step1_vbat = <0xFA0>;
                idvchg_ss_step2_vbat = <0x1068>;
                idvchg_ss_vta_step1 = <0xC8>;
                idvchg_ss_vta_step2 = <0xC8>;
                ta_blanking = <0x190>;
                swchg_aicr = <0x0>;
                swchg_ichg = <0x4B0>;
                swchg_aicr_ss_init = <0x190>;
                swchg_aicr_ss_step = <0xC8>;
                swchg_off_vbat = <0x109A>;
                force_ta_cv_vbat = <0x1130>;
                chg_time_max = <0x4650>;
                tta_level_def = <0x0 0x0 0x0 0x0 0x19 0x46 0x50 0x5A 0x5F>;
                tta_curlmt = <0x0 0x0 0x0 0x0 0x0 0x12C 0x258 0x384 0xFFFFFFFF>;
                tta_recovery_area = <0x3>;
                tbat_level_def = <0x14 0x14 0x14 0x14 0x19 0x29 0x2A 0x2B 0x2D>;
                tbat_curlmt = <0xFFFFFFFF 0xFFFFFFFF 0xFFFFFFFF 0x1F4 0x0 0xFA 0x2EE 0x4E2 0xFFFFFFFF>;
                tbat_recovery_area = <0x3>;
                tdvchg_level_def = <0x0 0x0 0x0 0x5 0x19 0x46 0x4B 0x50 0x55>;
                tdvchg_curlmt = <0xFFFFFFFF 0xFFFFFFFF 0xFFFFFFFF 0x12C 0x0 0x12C 0x258 0x384 0xFFFFFFFF>;
                tdvchg_recovery_area = <0x3>;
                tswchg_level_def = <0x0 0x0 0x0 0x5 0x19 0x41 0x46 0x4B 0x50>;
                tswchg_curlmt = <0xFFFFFFFF 0xFFFFFFFF 0xFFFFFFFF 0xC8 0x0 0xC8 0x12C 0x190 0xFFFFFFFF>;
                tswchg_recovery_area = <0x3>;
                ifod_threshold = <0xC8>;
                rsw_min = <0x14>;
                ircmp_rbat = <0x5>;
                ircmp_vclamp = <0xA>;
                vta_cap_min = <0x1A90>;
                vta_cap_max = <0x2904>;
                ita_cap_min = <0x3E8>;
                vbus_max_ovp = <0x2AF8>;
                ibat_max = <0x1B58>;
                cv_reduce_step = <0x3>;
                support_ta = "pca_ta_pps", "pca_ta_rfc";
                allow_not_check_ta_status;
                rechg_ab_h = <0x29 0xFFFFFFFF 0xFFFFFFFF 0xFFFFFFFF 0xFFFFFFFF 0xFFFFFFFF>;
                rechg_ab_l = <0x16 0xFFFFFFFF 0xFFFFFFFF 0xFFFFFFFF 0xFFFFFFFF 0xFFFFFFFF>;
                dv2_ab_dev = <0x0 0x0 0x0 0x0 0x0 0x0>;
                tpcb_level_def = <0x0 0x0 0x0 0x0 0x19 0x29 0x2A 0x2B 0x5A>;
                tpcb_curlmt = <0x0 0x0 0x0 0x0 0x0 0x1F4 0x3E8 0x5DC 0xFFFFFFFF>;
                tusb_level_def = <0x0 0x0 0x0 0x0 0x19 0x41 0x46 0x50 0x5A>;
                tusb_curlmt = <0x0 0x0 0x0 0x0 0x0 0x0 0x0 0x0 0xFFFFFFFF>;
                dv2_ffc_vbat = <0x1004 0x1180 0x1180 0x1180 0x1180>;
                dv2_ffc_ibat = <0xBB8 0x8CA 0x8CA 0x8CA 0x8CA>;
                dv2_ffc_vbat_low = <0x1004 0x1180 0x1180 0x1180>;
                dv2_ffc_ibat_low = <0xBB8 0x9C4 0x9C4 0x9C4>;
                dv2_ffc_vbat_mid = <0x1180 0x1180 0x1180 0x1180>;
                dv2_ffc_ibat_mid = <0x8CA 0x9C4 0x9C4 0x9C4>;
                dv2_ffc_vbat_high = <0x1180 0x1180 0x1180 0x1180>;
                dv2_ffc_ibat_high = <0x8CA 0x9C4 0x9C4 0x9C4>;
                dv2_ffc_vbat_high_ext1 = <0x1180 0x1180 0x1180 0x1180>;
                dv2_ffc_ibat_high_ext1 = <0x8CA 0x9C4 0x9C4 0x9C4>;
                dv2_ffc_vbat_high_ext2 = <0x1180 0x1180 0x1180 0x1180>;
                dv2_ffc_ibat_high_ext2 = <0x8CA 0x9C4 0x9C4 0x9C4>;
                dv2_ffc_vbat_low_lt = <0x1004 0x1180 0x1180 0x1180>;
                dv2_ffc_ibat_low_lt = <0xBB8 0x9C4 0x9C4 0x9C4>;
                dv2_ffc_vbat_mid_lt = <0x1180 0x1180 0x1180 0x1180>;
                dv2_ffc_ibat_mid_lt = <0x8CA 0x9C4 0x9C4 0x9C4>;
                dv2_ffc_vbat_high_lt = <0x1180 0x1180 0x1180 0x1180>;
                dv2_ffc_ibat_high_lt = <0x8CA 0x9C4 0x9C4 0x9C4>;
                dv2_ffc_vbat_high_ext1_lt = <0x1180 0x1180 0x1180 0x1180>;
                dv2_ffc_ibat_high_ext1_lt = <0x8CA 0x9C4 0x9C4 0x9C4>;
                dv2_ffc_vbat_high_ext2_lt = <0x1180 0x1180 0x1180 0x1180>;
                dv2_ffc_ibat_high_ext2_lt = <0x8CA 0x9C4 0x9C4 0x9C4>;
                idvchg_pps_term = <0x4B0>;
                game_limit_ita = <0x5DC>;
            };
        };
    };
    fragment@37 {
        target = <0xFFFFFFFF>;
        __overlay__ {
            adc_channel@ {
                compatible = "mediatek,adc_channel";
                mediatek,temperature0 = <0x0>;
                mediatek,temperature1 = <0x1>;
                mediatek,adc_fdd_rf_params_dynamic_custom_ch = <0x5>;
                status = "okay";
            };
        };
    };
    fragment@38 {
        target = <0xFFFFFFFF>;
        __overlay__ {
            io-channels = <0xFFFFFFFF 0x5>;
        };
    };
    fragment@39 {
        target = <0xFFFFFFFF>;
        __overlay__ {
            mediatek,clkbuf-quantity = <0x7>;
            mediatek,clkbuf-config = <0x2 0x1 0x1 0x2 0x0 0x0 0x1>;
            mediatek,clkbuf-output-impedance = <0x3 0x4 0x3 0x4 0x0 0x0 0x3>;
            mediatek,clkbuf-controls-for-desense = <0x0 0x4 0x0 0x4 0x0 0x0 0x0>;
            status = "okay";
        };
    };
    fragment@40 {
        target = <0xFFFFFFFF>;
        __overlay__ {
            #address-cells = <0x1>;
            #size-cells = <0x0>;
            clock-frequency = <0x61A80>;
            mediatek,use-open-drain;
        };
    };
    fragment@41 {
        target = <0xFFFFFFFF>;
        __overlay__ {
            #address-cells = <0x1>;
            #size-cells = <0x0>;
            clock-frequency = <0x61A80>;
            mediatek,use-open-drain;
        };
    };
    fragment@42 {
        target = <0xFFFFFFFF>;
        __overlay__ {
            #address-cells = <0x1>;
            #size-cells = <0x0>;
            clock-frequency = <0x61A80>;
            mediatek,use-open-drain;
            camera_main@10 {
                compatible = "mediatek,camera_main";
                reg = <0x10>;
                status = "okay";
                phandle = <0x61>;
            };
            camera_main_af@0c {
                compatible = "mediatek,camera_main_af";
                reg = <0xC>;
                status = "okay";
                phandle = <0x62>;
            };
        };
    };
    fragment@43 {
        target = <0xFFFFFFFF>;
        __overlay__ {
            #address-cells = <0x1>;
            #size-cells = <0x0>;
            clock-frequency = <0x61A80>;
            mediatek,use-open-drain;
            nfc@28 {
                compatible = "mediatek,nfc";
                reg = <0x28>;
                status = "okay";
                phandle = <0x63>;
            };
        };
    };
    fragment@44 {
        target = <0xFFFFFFFF>;
        __overlay__ {
            #address-cells = <0x1>;
            #size-cells = <0x0>;
            clock-frequency = <0x61A80>;
            mediatek,use-open-drain;
            camera_sub_two@10 {
                compatible = "mediatek,camera_sub_two";
                reg = <0x10>;
                status = "okay";
                phandle = <0x64>;
            };
        };
    };
    fragment@45 {
        target = <0xFFFFFFFF>;
        __overlay__ {
            #address-cells = <0x1>;
            #size-cells = <0x0>;
            clock-frequency = <0x33E140>;
            mediatek,use-push-pull;
            subpmic@34 {
                compatible = "mediatek,subpmic";
                reg = <0x34>;
                status = "okay";
                phandle = <0x65>;
            };
            usb_type_c@4e {
                compatible = "mediatek,usb_type_c";
                reg = <0x4E>;
                status = "okay";
                phandle = <0x66>;
            };
            subpmic_pmic@1a {
                compatible = "mediatek,subpmic_pmic";
                reg = <0x1A>;
                status = "okay";
                phandle = <0x67>;
            };
            subpmic_ldo@64 {
                compatible = "mediatek,subpmic_ldo";
                reg = <0x64>;
                status = "okay";
                phandle = <0x68>;
            };
        };
    };
    fragment@46 {
        target = <0xFFFFFFFF>;
        __overlay__ {
            #address-cells = <0x1>;
            #size-cells = <0x0>;
            clock-frequency = <0x61A80>;
            mediatek,use-open-drain;
            i2c_lcd_bias@3e {
                compatible = "mediatek,i2c_lcd_bias";
                reg = <0x3E>;
                status = "okay";
                phandle = <0x69>;
            };
            strobe_main@63 {
                compatible = "mediatek,strobe_main";
                reg = <0x63>;
                status = "okay";
                phandle = <0x6A>;
            };
        };
    };
    fragment@47 {
        target = <0xFFFFFFFF>;
        __overlay__ {
            #address-cells = <0x1>;
            #size-cells = <0x0>;
            clock-frequency = <0x61A80>;
            mediatek,use-open-drain;
        };
    };
    fragment@48 {
        target = <0xFFFFFFFF>;
        __overlay__ {
            #address-cells = <0x1>;
            #size-cells = <0x0>;
            clock-frequency = <0x61A80>;
            mediatek,use-open-drain;
            camera_main_two@10 {
                compatible = "mediatek,camera_main_two";
                reg = <0x10>;
                status = "okay";
                phandle = <0x6B>;
            };
        };
    };
    fragment@49 {
        target = <0xFFFFFFFF>;
        __overlay__ {
            #address-cells = <0x1>;
            #size-cells = <0x0>;
            clock-frequency = <0x61A80>;
            mediatek,use-open-drain;
            camera_sub@20 {
                compatible = "mediatek,camera_sub";
                reg = <0x20>;
                status = "okay";
                phandle = <0x6C>;
            };
        };
    };
    fragment@50 {
        target = <0xFFFFFFFF>;
        __overlay__ {
            #address-cells = <0x1>;
            #size-cells = <0x0>;
            clock-frequency = <0x61A80>;
            mediatek,use-open-drain;
        };
    };
    fragment@51 {
        target = <0xFFFFFFFF>;
        __overlay__ {
            #address-cells = <0x1>;
            #size-cells = <0x0>;
            clock-frequency = <0x186A0>;
            mediatek,use-open-drain;
        };
    };
    fragment@52 {
        target = <0xFFFFFFFF>;
        __overlay__ {
            GPIO_RF_PWREN_RST_PIN = <0xFFFFFFFF 0x4B 0x0>;
            GPIO_SIM2_SIO = <0xFFFFFFFF 0xAA 0x0>;
            GPIO_SIM2_SCLK = <0xFFFFFFFF 0xAB 0x0>;
            GPIO_SIM2_SRST = <0xFFFFFFFF 0xAC 0x0>;
            GPIO_SIM1_SRST = <0xFFFFFFFF 0xAD 0x0>;
            GPIO_SIM1_SCLK = <0xFFFFFFFF 0xAE 0x0>;
            GPIO_SIM1_SIO = <0xFFFFFFFF 0xAF 0x0>;
            GPIO_SIM1_HOT_PLUG = <0xFFFFFFFF 0xB0 0x0>;
        };
    };
    fragment@53 {
        target = <0xFFFFFFFF>;
        __overlay__ {
            gpio_init_default = <0x0 0x0 0x0 0x0 0x1 0x1 0x1 0x1 0x0 0x0 0x0 0x1 0x0 0x1 0x2 0x0 0x0 0x0 0x1 0x1 0x1 0x3 0x0 0x0 0x0 0x1 0x1 0x1 0x4 0x0 0x0 0x0 0x1 0x1 0x1 0x5 0x0 0x0 0x0 0x1 0x1 0x1 0x6 0x0 0x0 0x0 0x1 0x1 0x0 0x7 0x0 0x1 0x0 0x1 0x0 0x0 0x8 0x0 0x0 0x0 0x1 0x1 0x0 0x9 0x0 0x0 0x0 0x1 0x1 0x0 0xA 0x0 0x1 0x0 0x1 0x0 0x0 0xB 0x0 0x0 0x0 0x1 0x0 0x0 0xC 0x2 0x0 0x0 0x0 0x0 0x0 0xD 0x2 0x0 0x0 0x1 0x0 0x0 0xE 0x0 0x0 0x0 0x1 0x1 0x1 0xF 0x0 0x1 0x0 0x1 0x0 0x1 0x10 0x7 0x0 0x0 0x1 0x1 0x0 0x11 0x7 0x0 0x0 0x1 0x1 0x0 0x12 0x7 0x0 0x0 0x1 0x1 0x0 0x13 0x7 0x0 0x0 0x1 0x1 0x0 0x14 0x7 0x0 0x0 0x0 0x0 0x0 0x15 0x0 0x1 0x0 0x1 0x0 0x0 0x16 0x0 0x0 0x0 0x1 0x0 0x0 0x17 0x7 0x0 0x0 0x1 0x1 0x0 0x18 0x1 0x0 0x0 0x0 0x0 0x0 0x19 0x1 0x0 0x0 0x0 0x0 0x0 0x1A 0x1 0x0 0x0 0x1 0x1 0x0 0x1B 0x1 0x0 0x0 0x0 0x0 0x0 0x1C 0x1 0x0 0x0 0x1 0x1 0x0 0x1D 0x1 0x0 0x0 0x1 0x1 0x0 0x1E 0x1 0x0 0x0 0x1 0x1 0x0 0x1F 0x1 0x0 0x0 0x1 0x1 0x0 0x20 0x1 0x0 0x0 0x1 0x1 0x0 0x21 0x1 0x0 0x0 0x1 0x1 0x0 0x22 0x1 0x0 0x0 0x1 0x1 0x0 0x23 0x1 0x0 0x0 0x1 0x1 0x0 0x24 0x1 0x0 0x0 0x1 0x1 0x1 0x25 0x1 0x0 0x0 0x1 0x1 0x1 0x26 0x1 0x0 0x0 0x1 0x1 0x1 0x27 0x1 0x0 0x0 0x1 0x0 0x1 0x28 0x0 0x1 0x0 0x1 0x0 0x1 0x29 0x1 0x0 0x0 0x0 0x0 0x1 0x2A 0x1 0x0 0x0 0x0 0x0 0x1 0x2B 0x1 0x0 0x0 0x1 0x0 0x1 0x2C 0x1 0x0 0x0 0x1 0x0 0x1 0x2D 0x1 0x0 0x0 0x1 0x1 0x1 0x2E 0x1 0x0 0x0 0x0 0x0 0x0 0x2F 0x1 0x0 0x0 0x0 0x0 0x0 0x30 0x1 0x0 0x0 0x0 0x0 0x0 0x31 0x1 0x0 0x0 0x0 0x0 0x0 0x32 0x1 0x0 0x0 0x1 0x0 0x0 0x33 0x1 0x0 0x0 0x1 0x0 0x0 0x34 0x1 0x0 0x0 0x1 0x0 0x0 0x35 0x1 0x0 0x0 0x1 0x0 0x0 0x36 0x1 0x0 0x0 0x1 0x0 0x1 0x37 0x1 0x0 0x0 0x1 0x0 0x0 0x38 0x1 0x0 0x0 0x1 0x0 0x0 0x39 0x1 0x0 0x0 0x1 0x0 0x0 0x3A 0x1 0x0 0x0 0x1 0x0 0x0 0x3B 0x1 0x0 0x0 0x1 0x0 0x0 0x3C 0x1 0x0 0x0 0x0 0x0 0x1 0x3D 0x1 0x0 0x0 0x0 0x0 0x1 0x3E 0x1 0x0 0x0 0x0 0x0 0x1 0x3F 0x1 0x0 0x0 0x0 0x0 0x1 0x40 0x2 0x0 0x0 0x0 0x0 0x0 0x41 0x2 0x0 0x0 0x1 0x0 0x0 0x42 0x1 0x0 0x0 0x1 0x0 0x1 0x43 0x1 0x0 0x0 0x1 0x0 0x1 0x44 0x1 0x0 0x0 0x0 0x0 0x0 0x45 0x1 0x0 0x0 0x1 0x0 0x0 0x46 0x1 0x0 0x0 0x1 0x0 0x1 0x47 0x1 0x0 0x0 0x0 0x0 0x1 0x48 0x1 0x0 0x0 0x0 0x0 0x1 0x49 0x1 0x0 0x0 0x0 0x0 0x1 0x4A 0x1 0x0 0x0 0x0 0x0 0x1 0x4B 0x0 0x1 0x1 0x1 0x0 0x1 0x4C 0x1 0x0 0x0 0x0 0x0 0x1 0x4D 0x1 0x0 0x0 0x0 0x0 0x1 0x4E 0x1 0x0 0x0 0x1 0x0 0x1 0x4F 0x1 0x0 0x0 0x0 0x0 0x1 0x50 0x1 0x0 0x0 0x0 0x0 0x1 0x51 0x1 0x0 0x0 0x0 0x0 0x1 0x52 0x1 0x0 0x0 0x0 0x0 0x0 0x53 0x1 0x0 0x0 0x1 0x0 0x0 0x54 0x1 0x0 0x0 0x0 0x0 0x0 0x55 0x1 0x0 0x0 0x1 0x0 0x0 0x56 0x1 0x0 0x0 0x1 0x0 0x1 0x57 0x1 0x0 0x0 0x0 0x0 0x1 0x58 0x1 0x0 0x0 0x0 0x0 0x1 0x59 0x1 0x0 0x0 0x0 0x0 0x1 0x5A 0x1 0x0 0x0 0x0 0x0 0x1 0x5B 0x1 0x0 0x0 0x0 0x0 0x1 0x5C 0x1 0x0 0x0 0x0 0x0 0x1 0x5D 0x1 0x0 0x0 0x0 0x0 0x1 0x5E 0x1 0x0 0x0 0x0 0x0 0x1 0x5F 0x1 0x0 0x0 0x0 0x0 0x1 0x60 0x1 0x0 0x0 0x0 0x0 0x1 0x61 0x1 0x0 0x0 0x0 0x0 0x1 0x62 0x1 0x0 0x0 0x1 0x0 0x0 0x63 0x1 0x0 0x0 0x1 0x0 0x0 0x64 0x1 0x0 0x0 0x1 0x0 0x0 0x65 0x1 0x0 0x0 0x1 0x0 0x0 0x66 0x1 0x0 0x0 0x1 0x1 0x0 0x67 0x1 0x0 0x0 0x1 0x1 0x0 0x68 0x1 0x0 0x0 0x1 0x1 0x0 0x69 0x1 0x0 0x0 0x1 0x1 0x0 0x6A 0x1 0x0 0x0 0x1 0x1 0x0 0x6B 0x0 0x1 0x0 0x1 0x0 0x1 0x6C 0x0 0x1 0x0 0x1 0x0 0x1 0x6D 0x0 0x1 0x0 0x1 0x0 0x0 0x6E 0x0 0x1 0x0 0x0 0x0 0x0 0x6F 0x0 0x1 0x0 0x1 0x0 0x0 0x70 0x1 0x0 0x0 0x1 0x1 0x0 0x71 0x0 0x0 0x0 0x1 0x1 0x0 0x72 0x1 0x0 0x0 0x1 0x1 0x0 0x73 0x2 0x0 0x0 0x1 0x0 0x1 0x74 0x1 0x0 0x0 0x1 0x1 0x1 0x75 0x0 0x0 0x0 0x1 0x1 0x0 0x76 0x0 0x0 0x0 0x1 0x1 0x0 0x77 0x0 0x0 0x0 0x1 0x1 0x0 0x78 0x1 0x0 0x0 0x1 0x1 0x0 0x79 0x0 0x0 0x0 0x1 0x1 0x0 0x7A 0x7 0x0 0x0 0x1 0x1 0x1 0x7B 0x7 0x0 0x0 0x1 0x1 0x0 0x7C 0x7 0x0 0x0 0x1 0x1 0x0 0x7D 0x7 0x0 0x0 0x1 0x1 0x0 0x7E 0x2 0x0 0x0 0x1 0x0 0x0 0x7F 0x2 0x0 0x0 0x1 0x0 0x0 0x80 0x2 0x0 0x0 0x1 0x1 0x1 0x81 0x2 0x0 0x0 0x1 0x0 0x1 0x82 0x2 0x0 0x0 0x1 0x1 0x1 0x83 0x2 0x0 0x0 0x1 0x1 0x1 0x84 0x1 0x0 0x0 0x1 0x1 0x1 0x85 0x1 0x0 0x0 0x1 0x1 0x1 0x86 0x1 0x0 0x0 0x1 0x1 0x1 0x87 0x1 0x0 0x0 0x1 0x1 0x1 0x88 0x1 0x0 0x0 0x1 0x1 0x1 0x89 0x1 0x0 0x0 0x1 0x1 0x1 0x8A 0x0 0x1 0x0 0x0 0x0 0x0 0x8B 0x0 0x1 0x0 0x1 0x0 0x0 0x8C 0x0 0x1 0x0 0x1 0x0 0x1 0x8D 0x0 0x1 0x0 0x1 0x0 0x1 0x8E 0x0 0x1 0x0 0x1 0x0 0x0 0x8F 0x1 0x0 0x0 0x1 0x1 0x1 0x90 0x1 0x0 0x0 0x1 0x1 0x1 0x91 0x1 0x0 0x0 0x1 0x1 0x1 0x92 0x1 0x0 0x0 0x1 0x1 0x1 0x93 0x1 0x0 0x0 0x1 0x1 0x1 0x94 0x1 0x0 0x0 0x1 0x1 0x1 0x95 0x1 0x1 0x0 0x1 0x0 0x0 0x96 0x1 0x0 0x0 0x1 0x1 0x0 0x97 0x1 0x1 0x0 0x1 0x0 0x0 0x98 0x1 0x1 0x0 0x1 0x0 0x0 0x99 0x1 0x1 0x0 0x1 0x0 0x0 0x9A 0x0 0x0 0x0 0x1 0x1 0x0 0x9B 0x0 0x0 0x0 0x1 0x1 0x0 0x9C 0x3 0x0 0x0 0x1 0x1 0x0 0x9D 0x3 0x0 0x0 0x1 0x1 0x0 0x9E 0x0 0x0 0x0 0x1 0x1 0x0 0x9F 0x0 0x0 0x0 0x1 0x1 0x0 0xA0 0x0 0x0 0x0 0x1 0x1 0x0 0xA1 0x0 0x0 0x0 0x1 0x1 0x0 0xA2 0x0 0x0 0x0 0x1 0x1 0x0 0xA3 0x0 0x0 0x0 0x1 0x1 0x1 0xA4 0x1 0x0 0x0 0x1 0x1 0x0 0xA5 0x1 0x0 0x0 0x0 0x0 0x0 0xA6 0x1 0x0 0x0 0x1 0x1 0x0 0xA7 0x1 0x0 0x0 0x1 0x1 0x0 0xA8 0x1 0x0 0x0 0x1 0x1 0x0 0xA9 0x1 0x0 0x0 0x1 0x1 0x0 0xAA 0x1 0x0 0x0 0x1 0x1 0x1 0xAB 0x1 0x0 0x0 0x0 0x0 0x1 0xAC 0x1 0x0 0x0 0x0 0x0 0x1 0xAD 0x1 0x0 0x0 0x0 0x0 0x1 0xAE 0x1 0x0 0x0 0x0 0x0 0x1 0xAF 0x1 0x0 0x0 0x1 0x1 0x1 0xB0 0x1 0x0 0x0 0x1 0x1 0x1 0xB1 0x0 0x0 0x0 0x1 0x0 0x1 0xB2 0x1 0x0 0x0 0x1 0x0 0x0 0xB3 0x1 0x0 0x0 0x1 0x0 0x0 0xB4 0x0 0x1 0x0 0x0 0x0 0x1 0xB5 0x1 0x0 0x0 0x1 0x1 0x1 0xB6 0x1 0x0 0x0 0x1 0x1 0x0 0xB7 0x1 0x0 0x0 0x1 0x1 0x0 0xB8 0x1 0x0 0x0 0x1 0x1 0x0 0xB9 0x1 0x0 0x0 0x1 0x1 0x0 0xBA 0x1 0x0 0x0 0x1 0x1 0x1 0xBB 0x1 0x0 0x0 0x1 0x1 0x1 0xBC 0x0 0x1 0x0 0x1 0x0 0x0 0xBD 0x0 0x1 0x0 0x1 0x0 0x0 0xBE 0x1 0x0 0x0 0x1 0x1 0x0 0xBF 0x1 0x0 0x0 0x1 0x1 0x0 0xC0 0x1 0x0 0x0 0x1 0x1 0x0 0xC1 0x0 0x0 0x0 0x1 0x1 0x0 0xC2 0x0 0x0 0x0 0x1 0x1 0x0 0xC3 0x0 0x0 0x0 0x1 0x1 0x0 0xC4 0x0 0x0 0x0 0x1 0x0 0x0 0xC5 0x0 0x0 0x0 0x1 0x0 0x0 0xC6 0x0 0x0 0x0 0x1 0x0 0x0 0xC7 0x0 0x0 0x0 0x1 0x0 0x0 0xC8 0x0 0x0 0x0 0x1 0x0 0x0 0xC9 0x0 0x0 0x0 0x1 0x0 0x0 0xCA 0x0 0x0 0x0 0x1 0x0 0x0 0xCB 0x0 0x0 0x0 0x1 0x0 0x0 0xCC 0x0 0x0 0x0 0x1 0x0 0x0 0xCD 0x0 0x0 0x0 0x1 0x0 0x0 0xCE 0x0 0x0 0x0 0x1 0x0 0x0 0xCF 0x0 0x0 0x0 0x1 0x0 0x0 0xD0 0x0 0x0 0x0 0x1 0x0 0x0>;
        };
    };
    fragment@54 {
        target = <0xFFFFFFFF>;
        __overlay__ {
            interrupt-parent = <0xFFFFFFFF>;
            interrupts = <0x0 0x8>;
            status = "okay";
        };
    };
    fragment@55 {
        target = <0xFFFFFFFF>;
        __overlay__ {
            interrupt-parent = <0xFFFFFFFF>;
            interrupts = <0x3 0x4>;
            deb-gpios = <0xFFFFFFFF 0x3 0x0>;
            debounce = <0x186A0>;
            status = "okay";
        };
    };
    fragment@56 {
        target = <0xFFFFFFFF>;
        __overlay__ {
            interrupt-parent = <0xFFFFFFFF>;
            interrupts = <0x4 0x2>;
            status = "okay";
        };
    };
    fragment@57 {
        target = <0xFFFFFFFF>;
        __overlay__ {
            interrupt-parent = <0xFFFFFFFF>;
            interrupts = <0xE 0x2>;
            status = "okay";
        };
    };
    fragment@58 {
        target = <0xFFFFFFFF>;
        __overlay__ {
            interrupt-parent = <0xFFFFFFFF>;
            interrupts = <0x25 0x1>;
            status = "okay";
        };
    };
    fragment@59 {
        target = <0xFFFFFFFF>;
        __overlay__ {
            interrupt-parent = <0xFFFFFFFF>;
            interrupts = <0xA2 0x8>;
            status = "okay";
        };
    };
    fragment@60 {
        target = <0xFFFFFFFF>;
        __overlay__ {
            compatible = "mediatek,md1_sim1_hot_plug_eint-eint";
            interrupts = <0x0 0x8>;
            debounce = <0x0 0x2710>;
            dedicated = <0x0 0x0>;
            src_pin = <0x0 0x1>;
            sockettype = <0x0 0x0>;
            status = "okay";
        };
    };
    fragment@61 {
        target = <0xFFFFFFFF>;
        __overlay__ {
            regulator-name = "vcamio";
            regulator-default-on = <0x1>;
            status = "okay";
        };
    };
    fragment@62 {
        target = <0xFFFFFFFF>;
        __overlay__ {
            regulator-name = "vtp";
            regulator-default-on = <0x1>;
            status = "okay";
        };
    };
    fragment@63 {
        target = <0xFFFFFFFF>;
        __overlay__ {
            status = "okay";
        };
    };
    fragment@64 {
        target = <0xFFFFFFFF>;
        __overlay__ {
            vtouch-supply = <0xFFFFFFFF>;
            status = "okay";
        };
    };
    fragment@65 {
        target = <0xFFFFFFFF>;
        __overlay__ {
            mediatek,kpd-key-debounce = <0x400>;
            mediatek,kpd-sw-pwrkey = <0x74>;
            mediatek,kpd-hw-pwrkey = <0x8>;
            mediatek,kpd-use-extend-type = <0x0>;
            mediatek,kpd-hw-map-num = <0x48>;
            mediatek,kpd-hw-init-map = <0x73 0x72 0x0 0x0 0x0 0x0 0x0 0x0 0x0 0x0 0x0 0x0 0x0 0x0 0x0 0x0 0x0 0x0 0x0 0x0 0x0 0x0 0x0 0x0 0x0 0x0 0x0 0x0 0x0 0x0 0x0 0x0 0x0 0x0 0x0 0x0 0x0 0x0 0x0 0x0 0x0 0x0 0x0 0x0 0x0 0x0 0x0 0x0 0x0 0x0 0x0 0x0 0x0 0x0 0x0 0x0 0x0 0x0 0x0 0x0 0x0 0x0 0x0 0x0 0x0 0x0 0x0 0x0 0x0 0x0 0x0 0x0>;
            mediatek,kpd-pwrkey-eint-gpio = <0x0>;
            mediatek,kpd-pwkey-gpio-din = <0x0>;
            mediatek,kpd-hw-dl-key0 = <0x0>;
            mediatek,kpd-hw-dl-key1 = <0x1>;
            mediatek,kpd-hw-dl-key2 = <0x8>;
            mediatek,kpd-hw-recovery-key = <0x0>;
            mediatek,kpd-hw-factory-key = <0x1>;
            status = "okay";
        };
    };
    fragment@66 {
        target = <0xFFFFFFFF>;
        __overlay__ {
            cam0@0 {
                phandle = <0x32>;
                pins_cmd_dat {
                    pinmux = <0xA100>;
                    slew-rate = <0x1>;
                    output-low;
                };
            };
            cam0@1 {
                phandle = <0x33>;
                pins_cmd_dat {
                    pinmux = <0xA100>;
                    slew-rate = <0x1>;
                    output-high;
                };
            };
            cam1@0 {
                phandle = <0x34>;
                pins_cmd_dat {
                    pinmux = <0x9B00>;
                    slew-rate = <0x1>;
                    output-low;
                };
            };
            cam1@1 {
                phandle = <0x35>;
                pins_cmd_dat {
                    pinmux = <0x9B00>;
                    slew-rate = <0x1>;
                    output-high;
                };
            };
            cam2@0 {
                phandle = <0x36>;
                pins_cmd_dat {
                    pinmux = <0xA300>;
                    slew-rate = <0x1>;
                    output-low;
                };
            };
            cam2@1 {
                phandle = <0x37>;
                pins_cmd_dat {
                    pinmux = <0xA300>;
                    slew-rate = <0x1>;
                    output-high;
                };
            };
            cam3@0 {
                phandle = <0x38>;
                pins_cmd_dat {
                    pinmux = <0x9F00>;
                    slew-rate = <0x1>;
                    output-low;
                };
            };
            cam3@1 {
                phandle = <0x39>;
                pins_cmd_dat {
                    pinmux = <0x9F00>;
                    slew-rate = <0x1>;
                    output-high;
                };
            };
            camera_pins_cam0_mclk_off {
                phandle = <0x3A>;
                pins_cmd_dat {
                    pinmux = <0x9800>;
                    drive-strength = <0x1>;
                };
            };
            camera_pins_cam0_mclk_2ma {
                phandle = <0x3B>;
                pins_cmd_dat {
                    pinmux = <0x9801>;
                    drive-strength = <0x0>;
                };
            };
            camera_pins_cam0_mclk_4ma {
                phandle = <0x3C>;
                pins_cmd_dat {
                    pinmux = <0x9801>;
                    drive-strength = <0x1>;
                };
            };
            camera_pins_cam0_mclk_6ma {
                phandle = <0x3D>;
                pins_cmd_dat {
                    pinmux = <0x9801>;
                    drive-strength = <0x2>;
                };
            };
            camera_pins_cam0_mclk_8ma {
                phandle = <0x3E>;
                pins_cmd_dat {
                    pinmux = <0x9801>;
                    drive-strength = <0x3>;
                };
            };
            camera_pins_cam1_mclk_off {
                phandle = <0x3F>;
                pins_cmd_dat {
                    pinmux = <0x9500>;
                    drive-strength = <0x1>;
                };
            };
            camera_pins_cam1_mclk_2ma {
                phandle = <0x40>;
                pins_cmd_dat {
                    pinmux = <0x9501>;
                    drive-strength = <0x0>;
                };
            };
            camera_pins_cam1_mclk_4ma {
                phandle = <0x41>;
                pins_cmd_dat {
                    pinmux = <0x9501>;
                    drive-strength = <0x1>;
                };
            };
            camera_pins_cam1_mclk_6ma {
                phandle = <0x42>;
                pins_cmd_dat {
                    pinmux = <0x9501>;
                    drive-strength = <0x2>;
                };
            };
            camera_pins_cam1_mclk_8ma {
                phandle = <0x43>;
                pins_cmd_dat {
                    pinmux = <0x9501>;
                    drive-strength = <0x3>;
                };
            };
            camera_pins_cam2_mclk_off {
                phandle = <0x44>;
                pins_cmd_dat {
                    pinmux = <0x9900>;
                    drive-strength = <0x1>;
                };
            };
            camera_pins_cam2_mclk_2ma {
                phandle = <0x45>;
                pins_cmd_dat {
                    pinmux = <0x9901>;
                    drive-strength = <0x0>;
                };
            };
            camera_pins_cam2_mclk_4ma {
                phandle = <0x46>;
                pins_cmd_dat {
                    pinmux = <0x9901>;
                    drive-strength = <0x1>;
                };
            };
            camera_pins_cam2_mclk_6ma {
                phandle = <0x47>;
                pins_cmd_dat {
                    pinmux = <0x9901>;
                    drive-strength = <0x2>;
                };
            };
            camera_pins_cam2_mclk_8ma {
                phandle = <0x48>;
                pins_cmd_dat {
                    pinmux = <0x9901>;
                    drive-strength = <0x3>;
                };
            };
            camera_pins_cam3_mclk_off {
                phandle = <0x49>;
                pins_cmd_dat {
                    pinmux = <0x9700>;
                    drive-strength = <0x1>;
                };
            };
            camera_pins_cam3_mclk_2ma {
                phandle = <0x4A>;
                pins_cmd_dat {
                    pinmux = <0x9701>;
                    drive-strength = <0x0>;
                };
            };
            camera_pins_cam3_mclk_4ma {
                phandle = <0x4B>;
                pins_cmd_dat {
                    pinmux = <0x9701>;
                    drive-strength = <0x1>;
                };
            };
            camera_pins_cam3_mclk_6ma {
                phandle = <0x4C>;
                pins_cmd_dat {
                    pinmux = <0x9701>;
                    drive-strength = <0x2>;
                };
            };
            camera_pins_cam3_mclk_8ma {
                phandle = <0x4D>;
                pins_cmd_dat {
                    pinmux = <0x9701>;
                    drive-strength = <0x3>;
                };
            };
            camdefault {
                phandle = <0x31>;
            };
        };
    };
    fragment@67 {
        target = <0xFFFFFFFF>;
        __overlay__ {
            pinctrl-names = "default", "cam0_rst0", "cam0_rst1", "cam1_rst0", "cam1_rst1", "cam2_rst0", "cam2_rst1", "cam3_rst0", "cam3_rst1", "cam0_mclk_off", "cam0_mclk_2mA", "cam0_mclk_4mA", "cam0_mclk_6mA", "cam0_mclk_8mA", "cam1_mclk_off", "cam1_mclk_2mA", "cam1_mclk_4mA", "cam1_mclk_6mA", "cam1_mclk_8mA", "cam2_mclk_off", "cam2_mclk_2mA", "cam2_mclk_4mA", "cam2_mclk_6mA", "cam2_mclk_8mA", "cam3_mclk_off", "cam3_mclk_2mA", "cam3_mclk_4mA", "cam3_mclk_6mA", "cam3_mclk_8mA";
            pinctrl-0 = <0x31>;
            pinctrl-1 = <0x32>;
            pinctrl-2 = <0x33>;
            pinctrl-3 = <0x34>;
            pinctrl-4 = <0x35>;
            pinctrl-5 = <0x36>;
            pinctrl-6 = <0x37>;
            pinctrl-7 = <0x38>;
            pinctrl-8 = <0x39>;
            pinctrl-9 = <0x3A>;
            pinctrl-10 = <0x3B>;
            pinctrl-11 = <0x3C>;
            pinctrl-12 = <0x3D>;
            pinctrl-13 = <0x3E>;
            pinctrl-14 = <0x3F>;
            pinctrl-15 = <0x40>;
            pinctrl-16 = <0x41>;
            pinctrl-17 = <0x42>;
            pinctrl-18 = <0x43>;
            pinctrl-19 = <0x44>;
            pinctrl-20 = <0x45>;
            pinctrl-21 = <0x46>;
            pinctrl-22 = <0x47>;
            pinctrl-23 = <0x48>;
            pinctrl-24 = <0x49>;
            pinctrl-25 = <0x4A>;
            pinctrl-26 = <0x4B>;
            pinctrl-27 = <0x4C>;
            pinctrl-28 = <0x4D>;
            cam0_vcamio-supply = <0xFFFFFFFF>;
            cam1_vcamio-supply = <0xFFFFFFFF>;
            cam2_vcamio-supply = <0xFFFFFFFF>;
            cam3_vcamio-supply = <0xFFFFFFFF>;
            cam0_enable_sensor = "s5kjn1_mipi_raw";
            cam1_enable_sensor = "hi1631q_mipi_raw";
            cam2_enable_sensor = "gc02m1_mipi_raw";
            cam3_enable_sensor = "gc02m1macro_mipi_raw";
            status = "okay";
        };
    };
    fragment@68 {
        target = <0xFFFFFFFF>;
        __overlay__ {
            camera_eeprom0@50 {
                compatible = "mediatek,camera_eeprom";
                reg = <0x50>;
                status = "okay";
                phandle = <0x6D>;
            };
        };
    };
    fragment@69 {
        target = <0xFFFFFFFF>;
        __overlay__ {
            camera_eeprom1@51 {
                compatible = "mediatek,camera_eeprom";
                reg = <0x51>;
                status = "okay";
                phandle = <0x6E>;
            };
        };
    };
    fragment@70 {
        target = <0xFFFFFFFF>;
        __overlay__ {
            extldodefault {
                phandle = <0xF>;
            };
            extldo_en_high {
                phandle = <0x10>;
                pins_cmd_dat {
                    pinmux = <0x8B00>;
                    output-high;
                };
            };
            extldo_en_low {
                phandle = <0x11>;
                pins_cmd_dat {
                    pinmux = <0x8B00>;
                    output-low;
                };
            };
        };
    };
    fragment@71 {
        target = <0xFFFFFFFF>;
        __overlay__ {
            #address-cells = <0x1>;
            #size-cells = <0x0>;
            clock-frequency = <0x61A80>;
            mediatek,use-open-drain;
            cam_vdd_ext@28 {
                compatible = "mediatek,cam_vdd_ext";
                reg = <0x28>;
                status = "okay";
            };
        };
    };
    fragment@72 {
        target = <0xFFFFFFFF>;
        __overlay__ {
            aw36515default {
                phandle = <0xC>;
            };
            aw36515hwen_high {
                phandle = <0xD>;
                pins_cmd_dat {
                    pinmux = <0x8D00>;
                    slew-rate = <0x1>;
                    output-high;
                };
            };
            aw36515hwen_low {
                phandle = <0xE>;
                pins_cmd_dat {
                    pinmux = <0x8D00>;
                    slew-rate = <0x1>;
                    output-low;
                };
            };
        };
    };
    __symbols__ {
        nfc = "/fragment@2/__overlay__/nfc";
        irq_nfc = "/fragment@2/__overlay__/irq_nfc";
        irtx_gpio_led_default = "/fragment@4/__overlay__/irtx_gpio_led_def@gpio139";
        irtx_gpio_led_set = "/fragment@4/__overlay__/irtx_gpio_led_set@gpio139";
        mtkfb_pins_lcd_bias_enp1 = "/fragment@8/__overlay__/lcd_bias_enp1_gpio";
        mtkfb_pins_lcd_bias_enp0 = "/fragment@8/__overlay__/lcd_bias_enp0_gpio";
        mtkfb_pins_lcd_bias_enn1 = "/fragment@8/__overlay__/lcd_bias_enn1_gpio";
        mtkfb_pins_lcd_bias_enn0 = "/fragment@8/__overlay__/lcd_bias_enn0_gpio";
        mtkfb_pins_lcm_rst_out1_gpio = "/fragment@8/__overlay__/lcm_rst_out1_gpio";
        mtkfb_pins_lcm_rst_out0_gpio = "/fragment@8/__overlay__/lcm_rst_out0_gpio";
        mtkfb_pins_lcm_dsi_te = "/fragment@8/__overlay__/lcm_dsi_te";
        panel_in1 = "/fragment@11/__overlay__/panel1@0/port/endpoint";
        dsi_out = "/fragment@11/__overlay__/ports/port/endpoint";
        flashlights_aw36515 = "/fragment@12/__overlay__/flashlights_aw36515";
        cam_vdd_ext = "/fragment@12/__overlay__/cam_vdd_ext";
        led0 = "/fragment@12/__overlay__/led@0";
        led1 = "/fragment@12/__overlay__/led@1";
        led2 = "/fragment@12/__overlay__/led@2";
        led3 = "/fragment@12/__overlay__/led@3";
        led4 = "/fragment@12/__overlay__/led@4";
        led5 = "/fragment@12/__overlay__/led@5";
        led6 = "/fragment@12/__overlay__/led@6";
        vibrator0 = "/fragment@12/__overlay__/vibrator@0";
        fingerprint = "/fragment@12/__overlay__/fingerprint";
        fingerprint_default = "/fragment@14/__overlay__/fingerprint_default";
        fingerprint_eint = "/fragment@14/__overlay__/gpio22_eint";
        fingerprint_eint_pull_down = "/fragment@14/__overlay__/gpio22_eint_pull_down";
        fingerprint_rst_one = "/fragment@14/__overlay__/rst_out_one";
        fingerprint_rst_zero = "/fragment@14/__overlay__/rst_out_zero";
        gps_pins_default = "/fragment@15/__overlay__/gps_default";
        gps_l1_lna_pins_ol = "/fragment@15/__overlay__/gps_l1_lna@0";
        gps_l1_lna_pins_dsp_ctrl = "/fragment@15/__overlay__/gps_l1_lna@1";
        gps_l1_lna_pins_oh = "/fragment@15/__overlay__/gps_l1_lna@2";
        gps_l5_lna_pins_ol = "/fragment@15/__overlay__/gps_l5_lna@0";
        gps_l5_lna_pins_dsp_ctrl = "/fragment@15/__overlay__/gps_l5_lna@1";
        gps_l5_lna_pins_oh = "/fragment@15/__overlay__/gps_l5_lna@2";
        kpd_pins_default = "/fragment@19/__overlay__/kpdgpiodefault";
        ps_enable = "/fragment@22/__overlay__/ps_enable";
        ps_disable = "/fragment@22/__overlay__/ps_disable";
        sel_up = "/fragment@22/__overlay__/sel_up";
        sel_down = "/fragment@22/__overlay__/sel_down";
        ctp_pins_default = "/fragment@24/__overlay__/eint0default";
        ctp_pins_eint_as_int = "/fragment@24/__overlay__/eint@0";
        ctp_pins_eint_output0 = "/fragment@24/__overlay__/eintoutput0";
        ctp_pins_eint_output1 = "/fragment@24/__overlay__/eintoutput1";
        ctp_pins_rst_output0 = "/fragment@24/__overlay__/rstoutput0";
        ctp_pins_rst_output1 = "/fragment@24/__overlay__/rstoutput1";
        ctp_pins_spi_mode = "/fragment@24/__overlay__/spimode_default";
        tran_touch = "/fragment@25/__overlay__/touch@0";
        fs16xx = "/fragment@27/__overlay__/fs16xx@34";
        speaker_amp = "/fragment@28/__overlay__/speaker_amp@5c";
        gpio_otg = "/fragment@29/__overlay__/otg_init";
        gpio_otg_low = "/fragment@29/__overlay__/otg_low";
        gpio_otg_high = "/fragment@29/__overlay__/otg_high";
        gpio_meta = "/fragment@29/__overlay__/meta_init";
        gpio_meta_low = "/fragment@29/__overlay__/meta_low";
        gpio_meta_high = "/fragment@29/__overlay__/meta_high";
        tran_battery = "/fragment@31/__overlay__/tran_battery";
        tran_battery_aging = "/fragment@31/__overlay__/tran_battery_aging";
        pd_adapter = "/fragment@31/__overlay__/pd_adapter";
        usb_switch = "/fragment@31/__overlay__/usb_switch";
        camera_main_mtk = "/fragment@42/__overlay__/camera_main@10";
        camera_main_af_mtk = "/fragment@42/__overlay__/camera_main_af@0c";
        nfc_mtk = "/fragment@43/__overlay__/nfc@28";
        camera_sub_two_mtk = "/fragment@44/__overlay__/camera_sub_two@10";
        subpmic_mtk = "/fragment@45/__overlay__/subpmic@34";
        usb_type_c_mtk = "/fragment@45/__overlay__/usb_type_c@4e";
        subpmic_pmic_mtk = "/fragment@45/__overlay__/subpmic_pmic@1a";
        subpmic_ldo_mtk = "/fragment@45/__overlay__/subpmic_ldo@64";
        i2c_lcd_bias_mtk = "/fragment@46/__overlay__/i2c_lcd_bias@3e";
        strobe_main_mtk = "/fragment@46/__overlay__/strobe_main@63";
        camera_main_two_mtk = "/fragment@48/__overlay__/camera_main_two@10";
        camera_sub_mtk = "/fragment@49/__overlay__/camera_sub@20";
        camera_pins_cam0_rst_0 = "/fragment@66/__overlay__/cam0@0";
        camera_pins_cam0_rst_1 = "/fragment@66/__overlay__/cam0@1";
        camera_pins_cam1_rst_0 = "/fragment@66/__overlay__/cam1@0";
        camera_pins_cam1_rst_1 = "/fragment@66/__overlay__/cam1@1";
        camera_pins_cam2_rst_0 = "/fragment@66/__overlay__/cam2@0";
        camera_pins_cam2_rst_1 = "/fragment@66/__overlay__/cam2@1";
        camera_pins_cam3_rst_0 = "/fragment@66/__overlay__/cam3@0";
        camera_pins_cam3_rst_1 = "/fragment@66/__overlay__/cam3@1";
        camera_pins_cam0_mclk_off = "/fragment@66/__overlay__/camera_pins_cam0_mclk_off";
        camera_pins_cam0_mclk_2ma = "/fragment@66/__overlay__/camera_pins_cam0_mclk_2ma";
        camera_pins_cam0_mclk_4ma = "/fragment@66/__overlay__/camera_pins_cam0_mclk_4ma";
        camera_pins_cam0_mclk_6ma = "/fragment@66/__overlay__/camera_pins_cam0_mclk_6ma";
        camera_pins_cam0_mclk_8ma = "/fragment@66/__overlay__/camera_pins_cam0_mclk_8ma";
        camera_pins_cam1_mclk_off = "/fragment@66/__overlay__/camera_pins_cam1_mclk_off";
        camera_pins_cam1_mclk_2ma = "/fragment@66/__overlay__/camera_pins_cam1_mclk_2ma";
        camera_pins_cam1_mclk_4ma = "/fragment@66/__overlay__/camera_pins_cam1_mclk_4ma";
        camera_pins_cam1_mclk_6ma = "/fragment@66/__overlay__/camera_pins_cam1_mclk_6ma";
        camera_pins_cam1_mclk_8ma = "/fragment@66/__overlay__/camera_pins_cam1_mclk_8ma";
        camera_pins_cam2_mclk_off = "/fragment@66/__overlay__/camera_pins_cam2_mclk_off";
        camera_pins_cam2_mclk_2ma = "/fragment@66/__overlay__/camera_pins_cam2_mclk_2ma";
        camera_pins_cam2_mclk_4ma = "/fragment@66/__overlay__/camera_pins_cam2_mclk_4ma";
        camera_pins_cam2_mclk_6ma = "/fragment@66/__overlay__/camera_pins_cam2_mclk_6ma";
        camera_pins_cam2_mclk_8ma = "/fragment@66/__overlay__/camera_pins_cam2_mclk_8ma";
        camera_pins_cam3_mclk_off = "/fragment@66/__overlay__/camera_pins_cam3_mclk_off";
        camera_pins_cam3_mclk_2ma = "/fragment@66/__overlay__/camera_pins_cam3_mclk_2ma";
        camera_pins_cam3_mclk_4ma = "/fragment@66/__overlay__/camera_pins_cam3_mclk_4ma";
        camera_pins_cam3_mclk_6ma = "/fragment@66/__overlay__/camera_pins_cam3_mclk_6ma";
        camera_pins_cam3_mclk_8ma = "/fragment@66/__overlay__/camera_pins_cam3_mclk_8ma";
        camera_pins_default = "/fragment@66/__overlay__/camdefault";
        mtk_camera_eeprom0 = "/fragment@68/__overlay__/camera_eeprom0@50";
        mtk_camera_eeprom1 = "/fragment@69/__overlay__/camera_eeprom1@51";
        ext_ldo_pins_default = "/fragment@70/__overlay__/extldodefault";
        ext_ldo_pins_hwen_high = "/fragment@70/__overlay__/extldo_en_high";
        ext_ldo_pins_hwen_low = "/fragment@70/__overlay__/extldo_en_low";
        flashlights_aw36515_pins_default = "/fragment@72/__overlay__/aw36515default";
        flashlights_aw36515_pins_hwen_high = "/fragment@72/__overlay__/aw36515hwen_high";
        flashlights_aw36515_pins_hwen_low = "/fragment@72/__overlay__/aw36515hwen_low";
    };
    __fixups__ {
        chosen = "/fragment@0:target:0";
        irtx_pwm = "/fragment@1:target:0";
        pio = "/fragment@2:target:0", "/fragment@2/__overlay__/nfc:gpio-rst-std:0", "/fragment@2/__overlay__/nfc:gpio-irq-std:0", "/fragment@2/__overlay__/irq_nfc:interrupt-parent:0", "/fragment@3/__overlay__/nfc_nxp@28:nxp,pn544-irq:0", "/fragment@3/__overlay__/nfc_nxp@28:nxp,pn544-ven:0", "/fragment@3/__overlay__/nfc_nxp@28:nxp,pn544-fw-dwnld:0", "/fragment@4:target:0", "/fragment@5/__overlay__:mt6360,intr_gpio:0", "/fragment@5/__overlay__:mt6360,tc30_dp_gpio:0", "/fragment@5/__overlay__:mt6360,tc30_dm_gpio:0", "/fragment@7/__overlay__:mt6360pd,intr_gpio:0", "/fragment@8:target:0", "/fragment@11/__overlay__/panel1@0:reset-gpios:0", "/fragment@11/__overlay__/panel1@0:bias-gpios:0", "/fragment@11/__overlay__/panel1@0:bias-gpios:12", "/fragment@12/__overlay__/fingerprint:interrupt-parent:0", "/fragment@13/__overlay__/fingerprint@0:interrupt-parent:0", "/fragment@13/__overlay__/fingerprint@0:irq-gpio-std:0", "/fragment@13/__overlay__/fingerprint@0:reset-gpio-std:0", "/fragment@14:target:0", "/fragment@15:target:0", "/fragment@19:target:0", "/fragment@22:target:0", "/fragment@24:target:0", "/fragment@29:target:0", "/fragment@35/__overlay__/hl7138_master@55:hl7138,intr-gpios:0", "/fragment@52/__overlay__:GPIO_RF_PWREN_RST_PIN:0", "/fragment@52/__overlay__:GPIO_SIM2_SIO:0", "/fragment@52/__overlay__:GPIO_SIM2_SCLK:0", "/fragment@52/__overlay__:GPIO_SIM2_SRST:0", "/fragment@52/__overlay__:GPIO_SIM1_SRST:0", "/fragment@52/__overlay__:GPIO_SIM1_SCLK:0", "/fragment@52/__overlay__:GPIO_SIM1_SIO:0", "/fragment@52/__overlay__:GPIO_SIM1_HOT_PLUG:0", "/fragment@54/__overlay__:interrupt-parent:0", "/fragment@55/__overlay__:interrupt-parent:0", "/fragment@55/__overlay__:deb-gpios:0", "/fragment@56/__overlay__:interrupt-parent:0", "/fragment@57/__overlay__:interrupt-parent:0", "/fragment@58/__overlay__:interrupt-parent:0", "/fragment@59/__overlay__:interrupt-parent:0", "/fragment@66:target:0", "/fragment@70:target:0", "/fragment@72:target:0";
        i2c3 = "/fragment@3:target:0", "/fragment@43:target:0";
        mt6360_pmu = "/fragment@5:target:0";
        mt6360_pmic = "/fragment@6:target:0";
        mt6360_typec = "/fragment@7:target:0";
        mtkfb = "/fragment@9:target:0";
        dispsys_config = "/fragment@10:target:0";
        dsi0 = "/fragment@11:target:0";
        odm = "/fragment@12:target:0", "/fragment@31:target:0", "/fragment@36:target:0";
        spi5 = "/fragment@13:target:0";
        mt_pmic_vfp_ldo_reg = "/fragment@13/__overlay__/fingerprint@0:vmch-supply:0";
        gps = "/fragment@16:target:0";
        accdet = "/fragment@17:target:0";
        keypad = "/fragment@18:target:0", "/fragment@65:target:0";
        ps5169 = "/fragment@20:target:0";
        fusb340 = "/fragment@21:target:0";
        touch = "/fragment@23:target:0", "/fragment@57:target:0", "/fragment@64:target:0";
        spi4 = "/fragment@25:target:0";
        sound = "/fragment@26:target:0";
        i2c7 = "/fragment@27:target:0", "/fragment@47:target:0";
        i2c6 = "/fragment@28:target:0", "/fragment@46:target:0", "/fragment@71:target:0";
        u2port0 = "/fragment@30:target:0";
        i2c11 = "/fragment@32:target:0", "/fragment@35:target:0", "/fragment@51:target:0";
        charger = "/fragment@33:target:0";
        lk_charger = "/fragment@34:target:0";
        auxadc = "/fragment@37:target:0", "/fragment@38/__overlay__:io-channels:0";
        md_auxadc = "/fragment@38:target:0";
        pmic_clock_buffer_ctrl = "/fragment@39:target:0";
        i2c0 = "/fragment@40:target:0";
        i2c1 = "/fragment@41:target:0";
        i2c2 = "/fragment@42:target:0", "/fragment@68:target:0";
        i2c4 = "/fragment@44:target:0";
        i2c5 = "/fragment@45:target:0";
        i2c8 = "/fragment@48:target:0";
        i2c9 = "/fragment@49:target:0", "/fragment@69:target:0";
        i2c10 = "/fragment@50:target:0";
        gpio_usage_mapping = "/fragment@52:target:0";
        gpio = "/fragment@53:target:0";
        mrdump_ext_rst = "/fragment@54:target:0";
        msdc1_ins = "/fragment@55:target:0";
        subpmic_pmu_eint = "/fragment@56:target:0";
        dsi_te = "/fragment@58:target:0";
        rt5133_eint = "/fragment@59:target:0";
        md1_sim1_hot_plug_eint = "/fragment@60:target:0";
        mt_pmic_vcamio_ldo_reg = "/fragment@61:target:0", "/fragment@67/__overlay__:cam0_vcamio-supply:0", "/fragment@67/__overlay__:cam1_vcamio-supply:0", "/fragment@67/__overlay__:cam2_vcamio-supply:0", "/fragment@67/__overlay__:cam3_vcamio-supply:0";
        mt_pmic_vtp_ldo_reg = "/fragment@62:target:0", "/fragment@64/__overlay__:vtouch-supply:0";
        kd_camera_hw1 = "/fragment@63:target:0", "/fragment@67:target:0";
    };
    __local_fixups__ {
        fragment@1 {
            __overlay__ {
                pinctrl-0 = <0x0>;
                pinctrl-1 = <0x0>;
            };
        };
        fragment@9 {
            __overlay__ {
                pinctrl-0 = <0x0>;
                pinctrl-1 = <0x0>;
                pinctrl-2 = <0x0>;
                pinctrl-3 = <0x0>;
                pinctrl-4 = <0x0>;
                pinctrl-5 = <0x0>;
                pinctrl-6 = <0x0>;
            };
        };
        fragment@10 {
            __overlay__ {
                pinctrl-0 = <0x0>;
                pinctrl-1 = <0x0>;
                pinctrl-2 = <0x0>;
            };
        };
        fragment@11 {
            __overlay__ {
                panel1@0 {
                    port {
                        endpoint {
                            remote-endpoint = <0x0>;
                        };
                    };
                };
                ports {
                    port {
                        endpoint {
                            remote-endpoint = <0x0>;
                        };
                    };
                };
            };
        };
        fragment@12 {
            __overlay__ {
                flashlights_aw36515 {
                    pinctrl-0 = <0x0>;
                    pinctrl-1 = <0x0>;
                    pinctrl-2 = <0x0>;
                };
                cam_vdd_ext {
                    pinctrl-0 = <0x0>;
                    pinctrl-1 = <0x0>;
                    pinctrl-2 = <0x0>;
                };
                fingerprint {
                    pinctrl-0 = <0x0>;
                    pinctrl-1 = <0x0>;
                    pinctrl-2 = <0x0>;
                    pinctrl-3 = <0x0>;
                    pinctrl-4 = <0x0>;
                };
            };
        };
        fragment@13 {
            __overlay__ {
                fingerprint@0 {
                    pinctrl-0 = <0x0>;
                    pinctrl-1 = <0x0>;
                    pinctrl-2 = <0x0>;
                    pinctrl-3 = <0x0>;
                    pinctrl-4 = <0x0>;
                };
            };
        };
        fragment@16 {
            __overlay__ {
                pinctrl-0 = <0x0>;
                pinctrl-1 = <0x0>;
                pinctrl-2 = <0x0>;
                pinctrl-3 = <0x0>;
                pinctrl-4 = <0x0>;
                pinctrl-5 = <0x0>;
                pinctrl-6 = <0x0>;
            };
        };
        fragment@18 {
            __overlay__ {
                pinctrl-0 = <0x0>;
            };
        };
        fragment@20 {
            __overlay__ {
                pinctrl-0 = <0x0>;
                pinctrl-1 = <0x0>;
            };
        };
        fragment@21 {
            __overlay__ {
                pinctrl-0 = <0x0>;
                pinctrl-1 = <0x0>;
            };
        };
        fragment@23 {
            __overlay__ {
                pinctrl-0 = <0x0>;
                pinctrl-1 = <0x0>;
                pinctrl-2 = <0x0>;
                pinctrl-3 = <0x0>;
                pinctrl-4 = <0x0>;
                pinctrl-5 = <0x0>;
                pinctrl-6 = <0x0>;
            };
        };
        fragment@26 {
            __overlay__ {
                mediatek,speaker-codec {
                    sound-dai = <0x0>;
                };
            };
        };
        fragment@31 {
            __overlay__ {
                tran_battery {
                    pinctrl-0 = <0x0>;
                    pinctrl-1 = <0x0>;
                    pinctrl-2 = <0x0>;
                    pinctrl-3 = <0x0>;
                    pinctrl-4 = <0x0>;
                    pinctrl-5 = <0x0>;
                };
            };
        };
        fragment@67 {
            __overlay__ {
                pinctrl-0 = <0x0>;
                pinctrl-1 = <0x0>;
                pinctrl-2 = <0x0>;
                pinctrl-3 = <0x0>;
                pinctrl-4 = <0x0>;
                pinctrl-5 = <0x0>;
                pinctrl-6 = <0x0>;
                pinctrl-7 = <0x0>;
                pinctrl-8 = <0x0>;
                pinctrl-9 = <0x0>;
                pinctrl-10 = <0x0>;
                pinctrl-11 = <0x0>;
                pinctrl-12 = <0x0>;
                pinctrl-13 = <0x0>;
                pinctrl-14 = <0x0>;
                pinctrl-15 = <0x0>;
                pinctrl-16 = <0x0>;
                pinctrl-17 = <0x0>;
                pinctrl-18 = <0x0>;
                pinctrl-19 = <0x0>;
                pinctrl-20 = <0x0>;
                pinctrl-21 = <0x0>;
                pinctrl-22 = <0x0>;
                pinctrl-23 = <0x0>;
                pinctrl-24 = <0x0>;
                pinctrl-25 = <0x0>;
                pinctrl-26 = <0x0>;
                pinctrl-27 = <0x0>;
                pinctrl-28 = <0x0>;
            };
        };
    };
};
